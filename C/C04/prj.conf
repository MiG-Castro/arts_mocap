## CMakeLists.txt
```
#
# Copyright (c) 2018 Nordic Semiconductor
#
# SPDX-License-Identifier: LicenseRef-Nordic-5-Clause
#

cmake_minimum_required(VERSION 3.20.0)

find_package(Zephyr REQUIRED HINTS $ENV{ZEPHYR_BASE})
project(Central_BLE_v04)

FILE(GLOB app_sources src/*.c)
# NORDIC SDK APP START
target_sources(app PRIVATE
	${app_sources}
)
# NORDIC SDK APP END
```

## prj.conf
```kconfig
# ===================================================================
# HILOS/COLAS Y ASIGNACION DE ESPACIO
# ===================================================================
CONFIG_BT_RECV_WORKQ_BT=y
CONFIG_BT_RX_STACK_SIZE=2048

CONFIG_SYSTEM_WORKQUEUE_STACK_SIZE=4096
CONFIG_MAIN_STACK_SIZE=4096

CONFIG_SHELL=n
# CONFIG_SHELL_STACK_SIZE=4096

# ===================================================================
# CONSOLA Y LOGS
# ===================================================================
CONFIG_LOG=y
CONFIG_CBPRINTF_FP_SUPPORT=y

CONFIG_LOG_MODE_DEFERRED=y
CONFIG_LOG_BACKEND_UART=y
CONFIG_CONSOLE=y
CONFIG_USB_DEVICE_STACK=y
CONFIG_USB_CDC_ACM=y
CONFIG_UART_LINE_CTRL=y

# Habilita la API asíncrona, necesaria para la recepción en segundo plano
CONFIG_UART_ASYNC_API=y

# ===================================================================
# BLE
# ===================================================================
CONFIG_BT_DEVICE_NAME="Central_Dongle"
CONFIG_BT=y
CONFIG_BT_CENTRAL=y
CONFIG_BT_MAX_CONN=3
CONFIG_BT_CONN_CTX=y

# Filtros para el scan
CONFIG_BT_SCAN=y
CONFIG_BT_SCAN_FILTER_ENABLE=y
CONFIG_BT_SCAN_ADDRESS_CNT=4
CONFIG_BT_SCAN_UUID_CNT=2

# Configuracion GATT->Cliente
CONFIG_BT_GATT_CLIENT=y
CONFIG_BT_GATT_DM=y
CONFIG_BT_GATT_AUTO_DISCOVER_CCC=n
# Memoria dinamica de emergencia
CONFIG_HEAP_MEM_POOL_SIZE=2048

# Queremos total control en la actualizacion de parametros
CONFIG_BT_USER_DATA_LEN_UPDATE=y
CONFIG_BT_USER_PHY_UPDATE=y
CONFIG_BT_GAP_AUTO_UPDATE_CONN_PARAMS=n

CONFIG_BT_CTLR_DATA_LENGTH_MAX=251
CONFIG_BT_L2CAP_TX_MTU=247
CONFIG_BT_CTLR_PHY_2M=y

# PREPARACION DE BUFFERS MUY IMPORTANTE!!!
CONFIG_BT_CONN_TX_MAX=10
CONFIG_BT_ATT_TX_COUNT=10

CONFIG_BT_BUF_ACL_TX_COUNT=10
CONFIG_BT_BUF_ACL_TX_SIZE=251

CONFIG_BT_BUF_EVT_RX_COUNT=15
CONFIG_BT_BUF_ACL_RX_SIZE=251

# Para enviar paquetes muy grandes con Prepare Write Request
# CONFIG_BT_ATT_PREPARE_COUNT=2

# SEGURIDAD 
# CONFIG_BT_SMP=n
# CONFIG_BT_BONDABLE=n
```

## src/main.c
```c
/*
 * Central para el servicio IMU - Arquitectura Asíncrona
 * Funcional para multiconexion - Elemento clave "conn ctx" !!!
 * Central hace todas las solicitudes de actulizacion de parametros
 * Comunicacion UART 
 * - Hilo de recepcion con maquina de stados & checksum
 *   - Comandos & actualizacion de parametros
 * - Funcion de uart_tx
 */
#include <zephyr/kernel.h>
#include <zephyr/sys/printk.h>
#include <stdlib.h>
#include <zephyr/bluetooth/bluetooth.h>
#include <zephyr/bluetooth/conn.h>
#include <zephyr/bluetooth/gatt.h>
#include <zephyr/bluetooth/uuid.h>
#include <bluetooth/scan.h>
#include <bluetooth/gatt_dm.h>
#include <zephyr/shell/shell_uart.h>
#include <zephyr/sys/byteorder.h>
#include <bluetooth/conn_ctx.h>
#include <zephyr/logging/log.h>
#include <zephyr/drivers/uart.h>
#include "my_imu_ble_service.h"

#define LOG_MODULE_NAME central_main
LOG_MODULE_REGISTER(LOG_MODULE_NAME, LOG_LEVEL_INF);

#define MAX_CONNECTIONS 3

// ===================================================================
// COMUNICACIÓN UART
// ===================================================================
#define UART_DEVICE_NODE DT_CHOSEN(zephyr_console)
#define UART_RX_BUF_SIZE 128
#define UART_TX_BUF_SIZE 255
// #define UART_WAIT_FOR_BUF_DELAY K_MSEC(50)
// #define UART_RX_TIMEOUT_US 100000

// --- Protocolo UART ---
#define PKT_START_BYTE 0x7E
#define PKT_END_BYTE   0x7F

// Comandos: PC -> Dongle
#define CMD_TYPE_START_SCAN  0x20
#define CMD_TYPE_STOP_SCAN   0x21
#define CMD_TYPE_DISCONNECT  0x22
#define CMD_UPDATE_PARAMS    0x23
#define CMD_TYPE_SEND_CMD    0x30

// Mensajes: Dongle -> PC
#define MSG_TYPE_SENSOR_DATA 0x60
#define MSG_TYPE_EVENT_DATA  0x70

static bool scan_on = false;
static bool phy_2M = false;
static uint16_t conn_interv = 6, latency = 0, timeout_ms = 4000;
static uint16_t data_length = 251, tx_time = 2120;

// ===================================================================
// Parámetros de Conexión por Defecto
// ===================================================================
static struct bt_conn_le_phy_param *g_phy_param_2M = BT_CONN_LE_PHY_PARAM_2M;
static struct bt_conn_le_phy_param *g_phy_param_1M = BT_CONN_LE_PHY_PARAM_1M;
static struct bt_gatt_exchange_params exchange_params;
// static struct bt_conn_le_data_len_param *g_data_len_param = BT_LE_DATA_LEN_PARAM_MAX;

// --- Gestor de Contexto de Conexión ---
BT_CONN_CTX_DEF(conns, MAX_CONNECTIONS, sizeof(struct bt_imus_client));


// DECLARACIONES ADELANTADAS
static uint8_t on_gatt_notify(struct bt_conn *conn, struct bt_gatt_subscribe_params *params, const void *data, uint16_t length);
void send_uart_packet(uint8_t msg_type, uint8_t p_idx, const uint8_t *payload, uint16_t len);

static const struct device *uart_dev = DEVICE_DT_GET(UART_DEVICE_NODE);

// --- Hilo de Recepción UART ---
static void uart_rx_thread(void);
K_THREAD_DEFINE(uart_rx_tid, 1024, uart_rx_thread, NULL, NULL, NULL, 7, 0, 0);

// ===================================================================
// Funciones de Ayuda
// ===================================================================
// Función para obtener el índice de una conexión.
static int get_conn_index(struct bt_conn *conn)
{
    for (size_t i = 0; i < MAX_CONNECTIONS; i++) {
        const struct bt_conn_ctx *ctx = bt_conn_ctx_get_by_id(&conns_ctx_lib, i);
        if (ctx) {
            if (ctx->conn == conn) {
                bt_conn_ctx_release(&conns_ctx_lib, ctx->data);
                return i;
            }
            bt_conn_ctx_release(&conns_ctx_lib, ctx->data);
        }
    }
    return -1;
}

// ===================================================================
// Callbacks de la Aplicación
// ===================================================================
void on_write_completed(struct bt_conn *conn, uint8_t err, struct bt_gatt_write_params *params)
{LOG_INF("Comando enviado con exito");}

static uint8_t on_gatt_notify(struct bt_conn *conn, struct bt_gatt_subscribe_params *params, const void *data, uint16_t length)
{
    struct bt_imus_client *imus_client = bt_conn_ctx_get(&conns_ctx_lib, conn);
    if (!imus_client) return BT_GATT_ITER_STOP;

    int idx = get_conn_index(conn);

    if (!data) {
        LOG_INF("[Periférico %d] Suscripción habilitada para el handle 0x%04x", idx, params->value_handle);
        bt_conn_ctx_release(&conns_ctx_lib, imus_client);
        return BT_GATT_ITER_STOP;
    }
    
    if (params->value_handle == imus_client->sensordata_handle) {
        uint32_t packet_num = sys_get_le32(data);
        LOG_INF("[Periférico %d] Rx Notify pkt #%u", idx, packet_num);
        send_uart_packet(MSG_TYPE_SENSOR_DATA, (uint8_t)idx, data, length);
    } else if (params->value_handle == imus_client->exercisedetection_handle) {
        // CORRECCIÓN: Imprimir el índice en un log separado.
        LOG_INF("[Periférico %d] Rx indicate", idx);
        send_uart_packet(MSG_TYPE_EVENT_DATA, (uint8_t)idx, data, length);
    }

    bt_conn_ctx_release(&conns_ctx_lib, imus_client);
    return BT_GATT_ITER_CONTINUE;
}

// ===================================================================
// Callbacks de Conexión y Descubrimiento
// ===================================================================
static void discovery_complete(struct bt_gatt_dm *dm, void *context)
{
    struct bt_imus_client *imus_client = context;
    struct bt_conn *conn = (struct bt_conn *)bt_gatt_dm_conn_get(dm);
    int idx = get_conn_index(conn);

    int err = my_imus_handles_assign(dm, imus_client);
    if (err) {
        LOG_ERR("[Periférico %d] Fallo al asignar handles.", idx);
        bt_conn_disconnect(conn, BT_HCI_ERR_REMOTE_USER_TERM_CONN);
        return;
    }
    
    err = my_imus_subscribe_sensordata(conn, imus_client, on_gatt_notify);
    if (err) { LOG_ERR("[Periférico %d] Fallo al suscribirse a SensorData (err %d)", idx, err); }
    
    err = my_imus_subscribe_exercisedetection(conn, imus_client, on_gatt_notify);
    if (err) { LOG_ERR("[Periférico %d] Fallo al suscribirse a ExerciseDetection (err %d)", idx, err); }

    bt_gatt_dm_data_release(dm);
    LOG_INF("[Periférico %d] Suscipcion completa", idx);
    bt_scan_start(BT_SCAN_TYPE_SCAN_ACTIVE);
}

static struct bt_gatt_dm_cb discovery_cb = {.completed = discovery_complete};

// ===================================================================
// Callbacks de la Cadena de Configuración y Conexión
// ===================================================================

// --- Callbacks de la Máquina de Estados de Configuración ---
static void exchange_mtu_cb(struct bt_conn *conn, uint8_t err, struct bt_gatt_exchange_params *params)
{
	if (err) {
		LOG_ERR("Fallo en el intercambio de MTU (err %u)", err);
		bt_conn_disconnect(conn, BT_HCI_ERR_REMOTE_USER_TERM_CONN);
		return;
	}
	LOG_INF("MTU set to %d bytes", bt_gatt_get_mtu(conn) - 3);

    // PASO FINAL: Iniciar el descubrimiento de servicios
    struct bt_imus_client *imus_client = bt_conn_ctx_get(&conns_ctx_lib, conn);
    if (!imus_client) return;

    int gatt_err = bt_gatt_dm_start(conn, BT_UUID_IMUS, &discovery_cb, imus_client);
    if (gatt_err) LOG_ERR("Fallo al iniciar el descubrimiento (err %d)", gatt_err);
    bt_conn_ctx_release(&conns_ctx_lib, imus_client);
}

static void on_data_len_updated(struct bt_conn *conn, struct bt_conn_le_data_len_info *info)
{
	LOG_INF("Data Length (Tx/Rx): %u/%u bytes, %u/%u us", 
        info->tx_max_len, info->rx_max_len, info->tx_max_time, info->rx_max_time);

    // PASO 4: Intercambiar MTU
    exchange_params.func = exchange_mtu_cb;
    int err = bt_gatt_exchange_mtu(conn, &exchange_params);
    if (err) LOG_ERR("Fallo en la petición de intercambio de MTU (err %d)", err);
}

static void on_conn_param_updated(struct bt_conn *conn, uint16_t interval, uint16_t latency, uint16_t timeout)
{
    double ci = interval * 1.25;
	uint16_t sto = timeout * 10;
	LOG_INF("Connection parameters set to %.2f ms, %d, %d ms", ci, latency, sto);

    // PASO 3: Actualizar Data Length
    struct bt_conn_le_data_len_param g_data_len_param = {
		.tx_max_len = data_length,
		.tx_max_time = tx_time,
	};

    int err = bt_conn_le_data_len_update(conn, &g_data_len_param);
    if (err) LOG_ERR("Fallo en la petición de DLE (err %d)", err);
}

static void on_phy_updated(struct bt_conn *conn, struct bt_conn_le_phy_info *param)
{
    if (param->tx_phy == BT_CONN_LE_TX_POWER_PHY_1M) LOG_INF("PHY set to 1M");
    if (param->tx_phy == BT_CONN_LE_TX_POWER_PHY_2M) LOG_INF("PHY set to 2M");

    uint16_t timeout = timeout_ms /10;
    struct bt_le_conn_param *g_conn_param = BT_LE_CONN_PARAM(
		conn_interv,    // Min Connection Interval = Value x 1.25ms
		conn_interv,    // Min Connection Interval = Value x 1.25ms
		latency,        // Latency (Number of connection intervals the peripheral can skip)
		timeout         // Time that the central will wait before disconnecting
	);

    int err = bt_conn_le_param_update(conn, g_conn_param);
    if (err) LOG_ERR("Fallo en la petición de parámetros de conexión (err %d)", err);
}

static void connected(struct bt_conn *conn, uint8_t hci_err)
{
    char addr[BT_ADDR_LE_STR_LEN];
    bt_addr_le_to_str(bt_conn_get_dst(conn), addr, sizeof(addr));

    if (hci_err) {
        LOG_ERR("Conexión fallida con %s (err 0x%02x)", addr, hci_err);
        return;
    }
    LOG_INF("Conectado con: %s. Iniciando configuración...", addr);

    bt_scan_stop();

    struct bt_imus_client *imus_client = bt_conn_ctx_alloc(&conns_ctx_lib, conn);
    if (!imus_client) {
        LOG_WRN("No hay memoria para el contexto.");
        bt_conn_disconnect(conn, BT_HCI_ERR_INSUFFICIENT_RESOURCES);
        return;
    }
    memset(imus_client, 0, sizeof(struct bt_imus_client));
    bt_conn_ctx_release(&conns_ctx_lib, imus_client);

    // PASO 1: Iniciar la cadena de configuración actualizando el PHY
    int err;
    if (phy_2M) err = bt_conn_le_phy_update(conn, g_phy_param_2M);
    else err = bt_conn_le_phy_update(conn, g_phy_param_1M);

    if (err) LOG_ERR("Fallo en la petición de PHY (err %d)", err);
}

static void disconnected(struct bt_conn *conn, uint8_t reason)
{
    char addr[BT_ADDR_LE_STR_LEN];
    bt_addr_le_to_str(bt_conn_get_dst(conn), addr, sizeof(addr));

    int idx = get_conn_index(conn);
    LOG_INF("Periferico %d - %s, desconectado (razón 0x%02x)", idx, addr, reason);
    bt_conn_ctx_free(&conns_ctx_lib, conn);

    if (scan_on) bt_scan_start(BT_SCAN_TYPE_SCAN_ACTIVE);
}

// Callbacks eventos BLE
static struct bt_conn_cb conn_callbacks = {
    .connected = connected,
    .disconnected = disconnected,
    .le_phy_updated = on_phy_updated,
    .le_param_updated = on_conn_param_updated,
    .le_data_len_updated = on_data_len_updated
};

// ===================================================================
// FUNCIONES UART
// ===================================================================

// Revisar la integridad del paquete recibido
static uint8_t calculate_checksum(const uint8_t *data, uint8_t len)
{
    uint8_t checksum = 0;
    for (int i = 0; i < len; i++) {
        checksum ^= data[i];
    }
    return checksum;
}

// Estructura del paquete: [START][LEN][TIPO][IDX][PAYLOAD][CS][END]
void send_uart_packet(uint8_t msg_type, uint8_t p_idx, const uint8_t *payload, uint16_t len)
{
    static uint8_t tx_buf[UART_TX_BUF_SIZE];
    if (len + 6 > UART_TX_BUF_SIZE) {
        LOG_ERR("Paquete UART demasiado grande para enviar (%u bytes)", len);
    } else {
        tx_buf[0] = PKT_START_BYTE;
        tx_buf[1] = (uint8_t)len;
        tx_buf[2] = msg_type;
        tx_buf[3] = p_idx;
        memcpy(&tx_buf[4], payload, len);

        // Checksum incluye TIPO, ÍNDICE, LONGITUD y PAYLOAD
        uint8_t checksum = calculate_checksum(&tx_buf[1], 3 + len);
        tx_buf[4 + len] = checksum;
        tx_buf[5 + len] = PKT_END_BYTE;
        // Send the packet
        for (int i = 0; i < (6 + len); i++) {uart_poll_out(uart_dev, tx_buf[i]);}
    }
}

static void handle_uart_command(uint8_t cmd_type, const uint8_t *payload, uint8_t len)
{
    switch (cmd_type) {
        case CMD_TYPE_START_SCAN:
            LOG_INF("UART CMD: Iniciar escaneo");
            bt_scan_start(BT_SCAN_TYPE_SCAN_ACTIVE);
            scan_on = true;
            break;

        case CMD_TYPE_STOP_SCAN:
            LOG_INF("UART CMD: Detener escaneo");
            bt_scan_stop();
            scan_on = false;
            break;
        
            case CMD_TYPE_DISCONNECT:
                uint8_t idx = payload[0];
                if (idx == 0xFF) {
                    LOG_INF("UART CMD: Desconectar TODOS");
                    for (size_t i = 0; i < MAX_CONNECTIONS; i++) {
                        const struct bt_conn_ctx *ctx = bt_conn_ctx_get_by_id(&conns_ctx_lib, i);
                        if (ctx) {
                            bt_conn_disconnect(ctx->conn, BT_HCI_ERR_REMOTE_USER_TERM_CONN);
                            bt_conn_ctx_release(&conns_ctx_lib, ctx->data);
                        }
                    }
                } else {
                    LOG_INF("UART CMD: Desconectar %d", idx);
                    const struct bt_conn_ctx *ctx = bt_conn_ctx_get_by_id(&conns_ctx_lib, idx);
                    if (ctx) {
                        bt_conn_disconnect(ctx->conn, BT_HCI_ERR_REMOTE_USER_TERM_CONN);
                        bt_conn_ctx_release(&conns_ctx_lib, ctx->data);
                    }
                }
                break;
        case CMD_UPDATE_PARAMS:
            if (len == 11) {

                // PHY
                if (payload[0] == 0x01) phy_2M = false;
                if (payload[0] == 0x02) phy_2M = true;
                
                // Connection Interval
                uint16_t n = sys_get_le16(&payload[1]);
                if (n >= 6 &&  n <= 3200) conn_interv = n;

                // Latency
                n = sys_get_le16(&payload[3]);
                if (n >= 0) latency = n;
                
                // Supervision time out
                n = sys_get_le16(&payload[5]);
                uint16_t cal_tout = DIV_ROUND_UP(((1 + latency) * conn_interv * 5), 4);
                if (n >= cal_tout) timeout_ms = n;
                else timeout_ms = cal_tout;

                // Data Length
                n = sys_get_le16(&payload[7]);
                if (n >= 27 &&  n <= 251) data_length = n; 

                // Tx/Rx time = TIEMPO QUE PUEDE TRANSMITIR O ESCUCHAR EL RADIO!!!
                // EL tiempo requerido depende de los datos a enviar y PHY.
                // Recomendacion: No mover y dejar en 2120us
                n = sys_get_le16(&payload[9]);
                if (n >= 328 &&  n <= 17040) tx_time = n;

                LOG_INF("Parameters Update: PHY=%s, CI=%.2fms (%u), L=%u, Sto=%ums, DL=%u, TxRx=%uus",
                    phy_2M ? "2M" : "1M", conn_interv*1.25, conn_interv, latency, timeout_ms, 
                    data_length, tx_time);
            }
            break;

        case CMD_TYPE_SEND_CMD:
            if (len >= 2) {
                uint8_t p_idx = payload[0];
                uint8_t ble_cmd = payload[1];
                LOG_INF("UART CMD: Enviar comando 0x%02X a periférico %u", ble_cmd, p_idx);
                
                // Broadcast
                if (p_idx == 0xFF) {
                    for (size_t i = 0; i < MAX_CONNECTIONS; i++) {
                        const struct bt_conn_ctx *ctx = bt_conn_ctx_get_by_id(&conns_ctx_lib, i);
                        if (ctx) {
                            my_imus_write_command(ctx->conn, ctx->data, &ble_cmd, 1, on_write_completed);
                            bt_conn_ctx_release(&conns_ctx_lib, ctx->data);
                        }
                    }
                } else {
                    const struct bt_conn_ctx *ctx = bt_conn_ctx_get_by_id(&conns_ctx_lib, p_idx);
                    if (ctx) {
                        my_imus_write_command(ctx->conn, ctx->data, &ble_cmd, 1, on_write_completed);
                        bt_conn_ctx_release(&conns_ctx_lib, ctx->data);
                    }
                }
            }
            break;
        default:
            LOG_WRN("Comando UART desconocido: 0x%02X", cmd_type);
            break;
    }
}

// Hilo de recepcion de UART
static void uart_rx_thread(void)
{
    uint8_t c;
    uint8_t buffer[UART_RX_BUF_SIZE];
    uint8_t len = 0, type = 0;
    int pos = 0;
    
    // Definimos los estados de nuestra máquina
    enum {
        STATE_WAIT_START,
        STATE_READ_LEN,
        STATE_READ_TYPE,
        STATE_READ_PAYLOAD,
        STATE_READ_CHECKSUM,
        STATE_READ_END
    } state = STATE_WAIT_START;

    while (true) {
        // 1. Intenta leer un byte. Si no hay, duerme y vuelve a intentarlo.
        if (uart_poll_in(uart_dev, &c)) {
            k_sleep(K_MSEC(10));
            continue;
        }

        // 2. Si hay un byte, lo procesamos según nuestro estado actual.
        switch (state) {
            case STATE_WAIT_START:
                if (c == PKT_START_BYTE) {
                    state = STATE_READ_LEN;
                    pos = 0;
                }
                break;

            case STATE_READ_LEN:
                len = c;
                // ¿El paquete cabe en nuestro buffer?
                // len + 3 = len del payload + tipo + checksum
                if (len + 3 > UART_RX_BUF_SIZE) {
                    LOG_WRN("UART: Longitud de payload inválida (%u). Descartando.", len);
                    state = STATE_WAIT_START; // Volvemos al inicio
                } else {
                    state = STATE_READ_TYPE;
                }
                break;

            case STATE_READ_TYPE:
                type = c;
                pos = 0;
                //Post incremento, se ejecuta el valor actual y despues del acceso al array se incrementa pos
                buffer[pos++] = type;
                // Si no hay payload, saltamos directo al checksum
                if (len == 0) state = STATE_READ_CHECKSUM;
                else state = STATE_READ_PAYLOAD;
                break;

            case STATE_READ_PAYLOAD:
                //Post incremento, se ejecuta el valor actual y despues del acceso al array se incrementa pos
                buffer[pos++] = c;
                if (pos > len) state = STATE_READ_CHECKSUM;
                break;

            case STATE_READ_CHECKSUM:
                {
                    uint8_t received_checksum = c;
                    // El checksum se calcula sobre tipo + payload
                    uint8_t calculated_checksum = calculate_checksum(buffer, len + 1);
                    
                    if (received_checksum == calculated_checksum) {
                        state = STATE_READ_END;
                    } else {
                        LOG_WRN("UART: Checksum incorrecto.");
                        state = STATE_WAIT_START;
                    }
                }
                break;

            case STATE_READ_END:
                if (c == PKT_END_BYTE) {
                     // El payload empieza en buffer[1]
                    handle_uart_command(type, &buffer[1], len);
                } else {
                    LOG_WRN("UART: Byte de fin incorrecto.");
                    // state = STATE_WAIT_START;
                }
                // En cualquier caso, hemos terminado con este paquete.
                state = STATE_WAIT_START; // Volvemos al inicio para buscar el siguiente.
                break;
        }
    }
}

// ===================================================================
// Inicialización
// ===================================================================
int main(void)
{
    int err;
    LOG_INF("Central - Dongle");

    if (!device_is_ready(uart_dev)) {
        LOG_ERR("Dispositivo UART no encontrado!");
        return 0;
    }

    err = bt_enable(NULL);
    if (err) return 0;
    bt_conn_cb_register(&conn_callbacks);

    // SCAN CONFIGURATION
    struct bt_le_conn_param *sc_conn_param = BT_LE_CONN_PARAM(6, 6, 0, 400);
    struct bt_le_scan_param scan_param = {
        .type = BT_SCAN_TYPE_SCAN_ACTIVE,
        .options = BT_LE_SCAN_OPT_FILTER_DUPLICATE,
        .interval = 0x0010,
        .window = 0x0010,};
    struct bt_scan_init_param scan_init = {
        .connect_if_match = 1,
        .scan_param = &scan_param,
        .conn_param = sc_conn_param};
    bt_scan_init(&scan_init);

    err = bt_scan_filter_add(BT_SCAN_FILTER_TYPE_UUID, BT_UUID_IMUS);
    if (err) { return 0; }
    err = bt_scan_filter_enable(BT_SCAN_UUID_FILTER, false);
    if (err) { return 0; }
    k_msleep(100);

    bt_scan_start(BT_SCAN_TYPE_SCAN_ACTIVE);
    
    LOG_INF("Inicializacion completa.");
    return 0;
}
```

## src/my_imu_ble_service.c
```c
/** @file
 *  @brief IMU Service (IMUS)
 */

#include <zephyr/types.h>
#include <stddef.h>
#include <string.h>
#include <errno.h>
#include <zephyr/sys/printk.h>
#include <zephyr/sys/byteorder.h>
#include <zephyr/kernel.h>
#include <zephyr/logging/log.h>
#include <zephyr/bluetooth/bluetooth.h>
#include <zephyr/bluetooth/hci.h>
#include <zephyr/bluetooth/conn.h>
#include <zephyr/bluetooth/uuid.h>
#include <zephyr/bluetooth/gatt.h>
#include <bluetooth/gatt_dm.h> 
#include "my_imu_ble_service.h"

LOG_MODULE_REGISTER(my_imus, LOG_LEVEL_INF);

// =============================================================================
// PERIPHERAL ROLE IMPLEMENTATION
// =============================================================================
#ifdef CONFIG_BT_PERIPHERAL

// --- Internal state variables ---
static bool sensordata_notify_enabled = false;
static bool exercisedetection_indicate_enabled = false;
static struct my_imus_cb imus_cb;

// --- Internal GATT callbacks ---

static void ccc_sensordata_cfg_changed(const struct bt_gatt_attr *attr, uint16_t value)
{
	sensordata_notify_enabled = (value == BT_GATT_CCC_NOTIFY);
	LOG_INF("Suscripción a SensorData %s", sensordata_notify_enabled ? "habilitada" : "deshabilitada");
}

static void ccc_exercisedetection_cfg_changed(const struct bt_gatt_attr *attr, uint16_t value)
{
	exercisedetection_indicate_enabled = (value == BT_GATT_CCC_INDICATE);
	LOG_INF("Suscripción a ExerciseDetection %s", exercisedetection_indicate_enabled ? "habilitada" : "deshabilitada");
}

static ssize_t write_command_cb(struct bt_conn *conn, const struct bt_gatt_attr *attr,
								const void *buf, uint16_t len, uint16_t offset, uint8_t flags)
{
	if (imus_cb.command_write_cb) {
		imus_cb.command_write_cb(buf, len);
		return len;
	}
	return BT_GATT_ERR(BT_ATT_ERR_WRITE_NOT_PERMITTED);
}

static void indicate_cb(struct bt_conn *conn, struct bt_gatt_indicate_params *params, uint8_t err)
{if (err != 0) LOG_WRN("Fallo en la indicación de ExerciseDetection (err %u)", err);}

/*
 * IMU Service Declaration (Order: Data, ExerciseDetection, Command)
 */
BT_GATT_SERVICE_DEFINE(
	// Atributes of the IMU Service
	// attrs[0]: IMU Service declaration.
	// attrs[1]: SensorData Characteristic declaration.
	// attrs[2]: CCCD of SensorData.
	// attrs[3]: Exercise Detection declaration.
	// attrs[4]: Value of Exercise Detection (Write and Indicate operations).
	// attrs[5]: CCCD of Exercise Detection.
	// attrs[6]: Command

	my_imus_svc,BT_GATT_PRIMARY_SERVICE(BT_UUID_IMUS),
	
	/* Characteristic 1: SensorData (Streaming) */
	BT_GATT_CHARACTERISTIC(BT_UUID_IMUS_DATA, BT_GATT_CHRC_NOTIFY,
						BT_GATT_PERM_NONE, NULL, NULL, NULL),
	BT_GATT_CCC(ccc_sensordata_cfg_changed, BT_GATT_PERM_READ | BT_GATT_PERM_WRITE),

	/* Characteristic 2: ExerciseDetection (Events) */
	BT_GATT_CHARACTERISTIC(BT_UUID_IMUS_EXDETECTION, BT_GATT_CHRC_INDICATE,
						BT_GATT_PERM_NONE, NULL, NULL, NULL),
	BT_GATT_CCC(ccc_exercisedetection_cfg_changed, BT_GATT_PERM_READ | BT_GATT_PERM_WRITE),

	/* Characteristic 3: Command (Control) */
	BT_GATT_CHARACTERISTIC(BT_UUID_IMUS_COMMAND, BT_GATT_CHRC_WRITE,
						BT_GATT_PERM_WRITE, NULL, write_command_cb, NULL)
);

// --- Public API for Peripheral ---
int my_imus_init(struct my_imus_cb *callbacks)
{
	if (callbacks) {
		imus_cb.command_write_cb = callbacks->command_write_cb;
	}
	return 0;
}

int my_imus_send_sensordata(const uint8_t *data, uint16_t len)
{
	if (!sensordata_notify_enabled) {
		return -EACCES;
	}
	// Atributo de SensorData: índice 1
	return bt_gatt_notify(NULL, &my_imus_svc.attrs[1], data, len);
}

bool is_sensordata_notify_enabled(void)
{return sensordata_notify_enabled;}

int my_imus_send_exercisedetection(const uint8_t *data, uint16_t len)
{
	if (!exercisedetection_indicate_enabled) {
		return -EACCES;
	}
	// Atributo de ExerciseDetection: índice 4
	static struct bt_gatt_indicate_params ind_params;
	ind_params.attr = &my_imus_svc.attrs[4];
	ind_params.func = indicate_cb;
	ind_params.data = data;
	ind_params.len = len;

	return bt_gatt_indicate(NULL, &ind_params);
}

bool is_exercisedetection_indicate_enabled(void)
{return exercisedetection_indicate_enabled;}

#endif // CONFIG_BT_PERIPHERAL


// =============================================================================
// CENTRAL ROLE IMPLEMENTATION
// =============================================================================
#ifdef CONFIG_BT_CENTRAL

int my_imus_handles_assign(struct bt_gatt_dm *dm, struct bt_imus_client *client)
{
	const struct bt_gatt_dm_attr *chrc_attr, *ccc_attr;

	// --- Característica 1: SensorData ---
	chrc_attr = bt_gatt_dm_char_by_uuid(dm, BT_UUID_IMUS_DATA);
	if (!chrc_attr) {
		LOG_ERR("No se encontró la característica SensorData.");
		return -ENOTSUP;
	}
	// El handle del VALOR es el handle de la declaración + 1.
	client->sensordata_handle = chrc_attr->handle + 1;

	ccc_attr = bt_gatt_dm_desc_by_uuid(dm, chrc_attr, BT_UUID_GATT_CCC);
	if (!ccc_attr) {
		LOG_ERR("No se encontró el CCCD para SensorData.");
		return -ENOTSUP;
	}
	client->sensordata_ccc_handle = ccc_attr->handle;

	// --- Característica 2: ExerciseDetection ---
	chrc_attr = bt_gatt_dm_char_by_uuid(dm, BT_UUID_IMUS_EXDETECTION);
	if (!chrc_attr) {
		LOG_ERR("No se encontró la característica ExerciseDetection.");
		return -ENOTSUP;
	}
	// El handle del VALOR es el handle de la declaración + 1.
	client->exercisedetection_handle = chrc_attr->handle + 1;

	ccc_attr = bt_gatt_dm_desc_by_uuid(dm, chrc_attr, BT_UUID_GATT_CCC);
	if (!ccc_attr) {
		LOG_ERR("No se encontró el CCCD para ExerciseDetection.");
		return -ENOTSUP;
	}
	client->exercisedetection_ccc_handle = ccc_attr->handle;

	// --- Característica 3: Command ---
	chrc_attr = bt_gatt_dm_char_by_uuid(dm, BT_UUID_IMUS_COMMAND);
	if (!chrc_attr) {
		LOG_ERR("No se encontró la característica Command.");
		return -ENOTSUP;
	}
	// El handle del VALOR es el handle de la declaración + 1.
	client->command_handle = chrc_attr->handle + 1;
	// Esta característica no tiene CCCD, por lo que no lo buscamos.

	LOG_INF("Handles del Servicio IMU asignados correctamente.");
	LOG_INF(" - SensorData (valor: 0x%04x, ccc: 0x%04x)", client->sensordata_handle, client->sensordata_ccc_handle);
	LOG_INF(" - ExDetection(valor: 0x%04x, ccc: 0x%04x)", client->exercisedetection_handle, client->exercisedetection_ccc_handle);
	LOG_INF(" - Command (valor: 0x%04x)", client->command_handle);

	return 0;
}

int my_imus_subscribe_sensordata(struct bt_conn *conn, struct bt_imus_client *client, bt_gatt_notify_func_t func)
{
	client->sub_params_sensordata.notify = func;
	client->sub_params_sensordata.value = BT_GATT_CCC_NOTIFY;
	client->sub_params_sensordata.value_handle = client->sensordata_handle;
	client->sub_params_sensordata.ccc_handle = client->sensordata_ccc_handle;
	// atomic_set_bit(client->sub_params_sensordata.flags, BT_GATT_SUBSCRIBE_FLAG_VOLATILE);
	return bt_gatt_subscribe(conn, &client->sub_params_sensordata);
}

int my_imus_subscribe_exercisedetection(struct bt_conn *conn, struct bt_imus_client *client, bt_gatt_notify_func_t func)
{
	client->sub_params_exercisedetection.notify = func;
	client->sub_params_exercisedetection.value = BT_GATT_CCC_INDICATE;
	client->sub_params_exercisedetection.value_handle = client->exercisedetection_handle;
	client->sub_params_exercisedetection.ccc_handle = client->exercisedetection_ccc_handle;
	// atomic_set_bit(client->sub_params_exercisedetection.flags, BT_GATT_SUBSCRIBE_FLAG_VOLATILE);
	return bt_gatt_subscribe(conn, &client->sub_params_exercisedetection);
}

int my_imus_write_command(struct bt_conn *conn, struct bt_imus_client *client, const uint8_t *cmd, uint16_t len, bt_gatt_write_func_t cb)
{
	static struct bt_gatt_write_params write_params;
	write_params.func = cb;
	write_params.handle = client->command_handle;
	write_params.offset = 0;
	write_params.data = cmd;
	write_params.length = len;
	return bt_gatt_write(conn, &write_params);
}

#endif // CONFIG_BT_CENTRAL
```
