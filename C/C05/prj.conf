## CMakeLists.txt
```
#
# Copyright (c) 2018 Nordic Semiconductor
#
# SPDX-License-Identifier: LicenseRef-Nordic-5-Clause
#

cmake_minimum_required(VERSION 3.20.0)

find_package(Zephyr REQUIRED HINTS $ENV{ZEPHYR_BASE})
project(Central_BLE_v05)

FILE(GLOB app_sources src/*.c)
# NORDIC SDK APP START
target_sources(app PRIVATE
	${app_sources}
)
# NORDIC SDK APP END
```

## prj.conf
```kconfig
# ===================================================================
# HILOS/COLAS Y ASIGNACION DE ESPACIO
# ===================================================================
CONFIG_BT_RECV_WORKQ_BT=y
CONFIG_BT_RX_STACK_SIZE=2048

CONFIG_SYSTEM_WORKQUEUE_STACK_SIZE=4096
CONFIG_MAIN_STACK_SIZE=4096

CONFIG_SHELL=n
# CONFIG_SHELL_STACK_SIZE=4096

# ===================================================================
# CONSOLA Y LOGS
# ===================================================================
CONFIG_LOG=y
CONFIG_BT_LOG_LEVEL_ERR=y
CONFIG_CBPRINTF_FP_SUPPORT=y

# CONFIG_LOG_MODE_DEFERRED=y
CONFIG_LOG_BACKEND_UART=y
CONFIG_CONSOLE=y
CONFIG_USB_DEVICE_STACK=y
CONFIG_USB_CDC_ACM=y
CONFIG_UART_LINE_CTRL=y

# Habilita la API asíncrona, necesaria para la recepción en segundo plano
CONFIG_UART_ASYNC_API=y

# ===================================================================
# BLE
# ===================================================================
CONFIG_BT_DEVICE_NAME="Xiao_Dongle"
CONFIG_BT=y
CONFIG_BT_CENTRAL=y
CONFIG_BT_MAX_CONN=3
CONFIG_BT_CONN_CTX=y

# Filtros para el scan
CONFIG_BT_SCAN=y
CONFIG_BT_SCAN_FILTER_ENABLE=y
CONFIG_BT_SCAN_ADDRESS_CNT=4
CONFIG_BT_SCAN_UUID_CNT=2

# Configuracion GATT->Cliente
CONFIG_BT_GATT_CLIENT=y
CONFIG_BT_GATT_DM=y
CONFIG_BT_GATT_AUTO_DISCOVER_CCC=n
# Memoria dinamica de emergencia
CONFIG_HEAP_MEM_POOL_SIZE=2048

# Queremos total control en la actualizacion de parametros
CONFIG_BT_USER_DATA_LEN_UPDATE=y
CONFIG_BT_USER_PHY_UPDATE=y
CONFIG_BT_GAP_AUTO_UPDATE_CONN_PARAMS=n

CONFIG_BT_CTLR_DATA_LENGTH_MAX=251
CONFIG_BT_L2CAP_TX_MTU=247
CONFIG_BT_CTLR_PHY_2M=y

# PREPARACION DE BUFFERS MUY IMPORTANTE!!!
CONFIG_BT_CONN_TX_MAX=10
CONFIG_BT_ATT_TX_COUNT=10

CONFIG_BT_BUF_ACL_TX_COUNT=10
CONFIG_BT_BUF_ACL_TX_SIZE=251

CONFIG_BT_BUF_EVT_RX_COUNT=15
CONFIG_BT_BUF_ACL_RX_SIZE=251

# CONFIG_BT_CTLR_SDC_MAX_CONN_EVENT_LEN_DEFAULT=1040
# Para enviar paquetes muy grandes con Prepare Write Request
# CONFIG_BT_ATT_PREPARE_COUNT=2

# SEGURIDAD 
# CONFIG_BT_SMP=n
# CONFIG_BT_BONDABLE=n
```

## src/my_imu_ble_service.h
```c
/**
 * @file my_imu_ble_service.h
 * @brief My IMU Service (IMUS) public API.
 *
 * This file contains the public API for the custom IMU BLE Service, which is
 * designed to handle sensor data streaming, command reception, and critical
 * event notifications between a Central and a Peripheral.
 */

#ifndef MY_IMU_BLE_SERVICE_H_
#define MY_IMU_BLE_SERVICE_H_

/**@file
 * @defgroup Bluetooth IMU Service API
 * @{
 * @brief API for the IMU Service (IMUS).
 */

#ifdef __cplusplus
extern "C" {
#endif

#include <zephyr/types.h>
#include <bluetooth/gatt_dm.h> // Necesario para struct bt_gatt_dm
#include <zephyr/bluetooth/conn.h>
#include <zephyr/bluetooth/uuid.h>
#include <zephyr/bluetooth/gatt.h>

/** @brief IMU Service UUID (random 128-bit UUID). */ 
#define BT_UUID_IMUS_VAL				BT_UUID_128_ENCODE(0x5cf33500, 0x538c, 0x4dc9, 0xb54b, 0x0b102623558d)

/** @brief SensorData Characteristic UUID. */
#define BT_UUID_IMUS_DATA_VAL			BT_UUID_128_ENCODE(0x5cf33501, 0x538c, 0x4dc9, 0xb54b, 0x0b102623558d)

/** @brief ExerciseDetection Characteristic UUID (for sending critical events to a Central).*/
#define BT_UUID_IMUS_EXDETECTION_VAL	BT_UUID_128_ENCODE(0x5cf33502, 0x538c, 0x4dc9, 0xb54b, 0x0b102623558d)

/** @brief Command Characteristic UUID (for receiving commands from a Central) */
#define BT_UUID_IMUS_COMMAND_VAL 		BT_UUID_128_ENCODE(0x5cf33503, 0x538c, 0x4dc9, 0xb54b, 0x0b102623558d)

#define BT_UUID_IMUS 				BT_UUID_DECLARE_128(BT_UUID_IMUS_VAL)
#define BT_UUID_IMUS_DATA 			BT_UUID_DECLARE_128(BT_UUID_IMUS_DATA_VAL)
#define BT_UUID_IMUS_EXDETECTION 	BT_UUID_DECLARE_128(BT_UUID_IMUS_EXDETECTION_VAL)
#define BT_UUID_IMUS_COMMAND 		BT_UUID_DECLARE_128(BT_UUID_IMUS_COMMAND_VAL)

// =============================================================================
// API for the PERIPHERAL ROLE
// =============================================================================
#ifdef CONFIG_BT_PERIPHERAL
/** @brief Callback function type for receiving data from the Command characteristic.
 *
 * @param[in] buf Pointer to the received data.
 * @param[in] len Length of the received data.
 */
typedef void (*command_write_cb_t)(const uint8_t *buf, uint16_t len);

/** @brief Structure for IMU Service application callbacks. */
struct my_imus_cb {
	/** @brief Callback function to be called when data is written to the Command characteristic by a client.*/
	command_write_cb_t command_write_cb;
};

/** @brief Initialize IMU Service.
 *
 * This function registers application callback functions with the My IMU
 * Service
 *
 * @param[in] callbacks Struct containing pointers to callback functions
 *			used by the service. This pointer can be NULL
 *			if no callback functions are defined.
 *
 * @retval 0 If the operation was successful.
 *           Otherwise, a (negative) error code is returned.
 */
int my_imus_init(struct my_imus_cb *callbacks);

/** @brief Send data to a CENTRAL. Requires ACK from client to ensuring delivery.
 *
 * @param[in] data Pointer of the byte array that contain the time of the detectet exercise.
 * @param[in] len The number of bytes to send.
 * 
 * @retval 0 If the operation was successful. Otherwise, a (negative) error code is returned.
 *
 */
int my_imus_send_exercisedetection(const uint8_t *data, uint16_t len);

/** @brief Get the indicate enable status.
 *
 * @retval 0 If the operation was successful. Otherwise, a (negative) error code is returned.
 */
bool is_exercisedetection_indicate_enabled(void);

/** @brief Send the sensor value as notification.
 *
 * This function sends an uint8_t array.
 *
 * @param[in] sensor_data Byte array that contain the sensor data.
 * @param[in] send_bytes The number of bytes to send.
 *
 * @retval 0 If the operation was successful.
 *           Otherwise, a (negative) error code is returned.
 */
int my_imus_send_sensordata(const uint8_t *sensor_data, uint16_t send_bytes);

/** @brief Get the notification enable status.
 *
 * @retval 0 If the operation was successful. Otherwise, a (negative) error code is returned.
 */
bool is_sensordata_notify_enabled(void);

#endif /* CONFIG_BT_PERIPHERAL */

// =============================================================================
// API for the CENTRAL ROLE
// =============================================================================
#ifdef CONFIG_BT_CENTRAL

/** @brief Structure to hold the handles discovered for the IMU Service. */
struct bt_imus_client {
	/** Handle of the SensorData characteristic value. */
	uint16_t sensordata_handle;
	/** Handle of the CCCD for the SensorData characteristic. */
	uint16_t sensordata_ccc_handle;
	/** GATT subscribe parameters for SensorData notifications. */
	struct bt_gatt_subscribe_params sub_params_sensordata;

	/** Handle of the ExerciseDetection characteristic value. */
	uint16_t exercisedetection_handle;
	/** Handle of the CCCD for the ExerciseDetection characteristic. */
	uint16_t exercisedetection_ccc_handle;
	/** GATT subscribe parameters for ExerciseDetection indications. */
	struct bt_gatt_subscribe_params sub_params_exercisedetection;
    
	/** Handle of the Command characteristic value. */
	uint16_t command_handle;
};

/**
 * @brief Assign handles discovered by the GATT Discovery Manager.
 *
 * @param[in] dm Pointer to the GATT Discovery Manager instance.
 * @param[out] client Pointer to the IMU Service client instance to populate.
 *
 * @retval 0 If successful. Otherwise, a (negative) error code is returned.
 */
int my_imus_handles_assign(struct bt_gatt_dm *dm, struct bt_imus_client *client);

/**
 * @brief Subscribe to SensorData notifications.
 *
 * @param[in] conn Pointer to the active connection.
 * @param[in] client Pointer to the initialized IMU Service client instance.
 * @param[in] func The callback function to handle incoming notifications.
 *
 * @retval 0 If successful. Otherwise, a (negative) error code is returned.
 */
int my_imus_subscribe_sensordata(struct bt_conn *conn, struct bt_imus_client *client, bt_gatt_notify_func_t func);

/**
 * @brief Subscribe to ExerciseDetection indications.
 *
 * @param[in] conn Pointer to the active connection.
 * @param[in] client Pointer to the initialized IMU Service client instance.
 * @param[in] func The callback function to handle incoming indications.
 *
 * @retval 0 If successful. Otherwise, a (negative) error code is returned.
 */
int my_imus_subscribe_exercisedetection(struct bt_conn *conn, struct bt_imus_client *client, bt_gatt_notify_func_t func);

/**
 * @brief Write a command to the Command characteristic.
 *
 * @param[in] conn Pointer to the active connection.
 * @param[in] client Pointer to the initialized IMU Service client instance.
 * @param[in] cmd Pointer to the command data to be sent.
 * @param[in] len Length of the command data.
 * @param[in] cb  Callback function for write completion. Can be NULL.
 *
 * @retval 0 If successful. Otherwise, a (negative) error code is returned.
 */
int my_imus_write_command(struct bt_conn *conn, struct bt_imus_client *client, const uint8_t *cmd, uint16_t len, bt_gatt_write_func_t cb);

#endif // CONFIG_BT_CENTRAL

#ifdef __cplusplus
}
#endif

/**
 * @}
 */

#endif /* MY_IMU_BLE_SERVICE_H_ */
```
