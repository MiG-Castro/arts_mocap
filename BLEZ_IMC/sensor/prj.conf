## CMakeLists.txt
```
cmake_minimum_required(VERSION 3.20.0)

find_package(Zephyr REQUIRED HINTS $ENV{ZEPHYR_BASE})
project(sensor_firmware)

# NORDIC SDK APP START
target_sources(app PRIVATE
  src/main.c
  src/my_imu_ble_service.c
  src/bno055_driver.c
)

# NORDIC SDK APP END
zephyr_library_include_directories(.)
```

## prj.conf
```kconfig
# Logs
CONFIG_LOG=y
CONFIG_BT_LOG_LEVEL_ERR=y
CONFIG_LOG_MODE_IMMEDIATE=y
CONFIG_LOG_BACKEND_UART=y

# Kernel y Stacks
CONFIG_BT_RX_STACK_SIZE=2048
CONFIG_MAIN_STACK_SIZE=4096
CONFIG_SYSTEM_WORKQUEUE_STACK_SIZE=2048
CONFIG_ISR_STACK_SIZE=2048

# Hardware Timer
CONFIG_COUNTER=y
CONFIG_CORTEX_M_DWT=y
CONFIG_CLOCK_CONTROL=y
CONFIG_CLOCK_CONTROL_NRF=y

# Drivers
CONFIG_GPIO=y
CONFIG_I2C=y
CONFIG_FPU=y

# BLE
CONFIG_BT=y
CONFIG_BT_PERIPHERAL=y
CONFIG_BT_DEVICE_NAME="Sensor_N"
CONFIG_BT_FILTER_ACCEPT_LIST=y
CONFIG_BT_GATT_CLIENT=y
CONFIG_BT_GAP_AUTO_UPDATE_CONN_PARAMS=n
CONFIG_BT_USER_DATA_LEN_UPDATE=y
CONFIG_BT_USER_PHY_UPDATE=y
CONFIG_BT_L2CAP_TX_MTU=500
CONFIG_BT_CTLR_DATA_LENGTH_MAX=251
CONFIG_BT_BUF_ACL_RX_SIZE=504 
CONFIG_BT_BUF_ACL_TX_SIZE=504

# Connection event length
CONFIG_BT_CTLR_SDC_MAX_CONN_EVENT_LEN_DEFAULT=3000
```

## xiao_ble_nrf52840.overlay
```dts
&i2c1 {
	status = "okay";
	clock-frequency = <I2C_BITRATE_FAST>; /* 400 kHz */
};
&uart0 {current-speed = <115200>;};
&timer2 {status = "okay";};
```

## src/main.c
```c
/*
 * BLEZ - Sensor Node Firmware
 * Author: Miguel Angel Castro-Perez, 2026
*/

#include <zephyr/kernel.h>
#include <zephyr/logging/log.h>
#include <zephyr/sys/byteorder.h>
// BLE
#include <zephyr/bluetooth/bluetooth.h>
#include <zephyr/bluetooth/gap.h>
#include <zephyr/bluetooth/uuid.h>
#include <zephyr/bluetooth/conn.h>
#include <zephyr/bluetooth/addr.h>
#include <zephyr/bluetooth/gatt.h>
// Timer
#include <zephyr/drivers/clock_control/nrf_clock_control.h>
#include <zephyr/drivers/clock_control.h>
#include <zephyr/drivers/counter.h>
#include <hal/nrf_clock.h>
#include <hal/nrf_timer.h>
#include <hal/nrf_power.h>
// gpio & sensor
#include <zephyr/drivers/gpio.h>
#include <zephyr/drivers/i2c.h>
// Include the custom IMU BLE service & BNO driver
#include "my_imu_ble_service.h"
#include "bno055_driver.h"

LOG_MODULE_REGISTER(P, LOG_LEVEL_INF);

//================================================================================
//                                LED configuration
//================================================================================
#define LED0_NODE DT_ALIAS(led0)
#define LED1_NODE DT_ALIAS(led1)
#define LED2_NODE DT_ALIAS(led2)
static const struct gpio_dt_spec red_led = GPIO_DT_SPEC_GET(LED0_NODE, gpios);
static const struct gpio_dt_spec grn_led = GPIO_DT_SPEC_GET(LED1_NODE, gpios);
static const struct gpio_dt_spec blu_led = GPIO_DT_SPEC_GET(LED2_NODE, gpios);

//================================================================================
//                                BLE configuration
//================================================================================
#define DEVICE_NAME CONFIG_BT_DEVICE_NAME	// Device Bluetooth name defined in prj.conf
#define DEVICE_NAME_LEN (sizeof(DEVICE_NAME) - 1)
struct bt_conn *my_conn = NULL;

// Address of the Central to connect
static const bt_addr_le_t target_addr = {
	// To add the address in the list, invert the sequence of the numbers
	// Example FB:5C:2A:77:77:0A -> .a = {.val = {0x0A, 0x77, 0x77, 0x2A, 0x5C, 0xFB}}
    .type = BT_ADDR_LE_RANDOM,
	// .a = {.val = {0x, 0x, 0x, 0x, 0x, 0x}}
	.a = {.val = {0x86, 0xD4, 0x3C, 0x99, 0x28, 0xFA}}
};
// Advertising parameters structure
static const struct bt_le_adv_param *adv_param = BT_LE_ADV_PARAM(
	BT_LE_ADV_OPT_CONN |			// Connectable advertising
	BT_LE_ADV_OPT_USE_IDENTITY |	// Use identity address (Static random address)
	BT_LE_ADV_OPT_FILTER_CONN, 		// Eneable Whitelist
	BT_GAP_ADV_FAST_INT_MIN_1,		// Min Advertising Interval = Value x 0.625ms = 30ms
	BT_GAP_ADV_FAST_INT_MAX_1,		// Max Advertising Interval = Value x 0.625ms = 60ms
	NULL							// Address of peer, Set to NULL for undirected advertising
);
// Definition of advertising data
static const struct bt_data ad[] = {
	BT_DATA_BYTES(BT_DATA_FLAGS, (BT_LE_AD_GENERAL |	// General advertising
		BT_LE_AD_NO_BREDR)),							// No compatible with BR/EDR (Bluetooth Classic)
	BT_DATA(BT_DATA_NAME_COMPLETE, DEVICE_NAME, DEVICE_NAME_LEN), // Use complete name
};
// Scan Response -> UUID of Service
static const struct bt_data sd[] = {BT_DATA_BYTES(BT_DATA_UUID128_ALL, BT_UUID_IMUS_VAL),};
// Work item for advertising & connection setup
static struct k_work adv_work;

//================================================================================
//                              Sensor & Sampling
//================================================================================
// BLE packet transmission thread configuration
#define SEND_STACKSIZE		4096
#define SEND_PRIORITY		8
// Sampling & packaging thread configuration
#define GETSAMPLE_STACKSIZE	4096
#define GETSAMPLE_PRIORITY	4

// SENSOR ========================================================================
#define I2C_NODE DT_NODELABEL(i2c1)
static const struct device *i2c1_dev = DEVICE_DT_GET(I2C_NODE);
static bool bno_ok = false;

// Sampling & packaging configuration
static uint64_t ts_us;
static uint32_t ts_ticks, fs_hz = 50;
static uint32_t n_pkt = 0, stop_pkt, counter_tx;
static uint8_t units, samples_x_pkt = 2, pkt_size;
// pkt to Tx
# define MAX_PACKET_SIZE 255
# define SAMPLE_SIZE 26   // Q=8B, Acc=6B, Mag=6B, G=6B
static uint8_t last_packet[MAX_PACKET_SIZE] = {0};
// control variables
static bool ble_tx = false, first_cycle = false;
static bool tx_notify = true, tx_indicate = false;

// 1. HARDWARE TIMER ========================================================
const struct device *hw_timer_dev = DEVICE_DT_GET(DT_NODELABEL(timer2));
static struct counter_alarm_cfg alarm_cfg0; // Alarm settings for timer
// 2. Dedicated workqueue for sensor reading outside ISR
static struct k_work_q sensor_work_q;
static struct k_work sensor_work;
K_KERNEL_STACK_MEMBER(sensor_work_q_stack, GETSAMPLE_STACKSIZE); // Work queue stack
// 3. Mailbox
static struct k_mutex packet_mutex;		// Mutex
static struct k_sem ble_data_sem;		// Semaphore

// BLE Send Thread
K_KERNEL_STACK_MEMBER(send_thread_stack, SEND_STACKSIZE); // TX thread stack
static struct k_thread send_thread_data; // Thread data structure
k_tid_t send_thread_tid;                 // Thread ID

// Stored movement data (quaternions) ============================================
static uint16_t idx = 0;
static int16_t motion_data[312] = {
	13924, -8583, -193, -914, 13959, -8528, -217, -906, 14001, -8459, -244, -895,
	14079, -8328, -323, -874, 14250, -8030, -411, -847, 14385, -7786, -435, -836,
	14546, -7477, -507, -825, 14811, -6923, -692, -817, 15059, -6358, -756, -809,
	15287, -5800, -746, -739, 15608, -4891, -711, -638, 15823, -4153, -697, -588,
	15992, -3451, -713, -538, 16176, -2443, -749, -500, 16263, -1753, -802, -491,
	16320, -1092, -812, -498, 16356, -227, -784, -486, 16352, 480, -799, -438,
	16311, 1246, -828, -386, 16207, 2216, -856, -357, 16096, 2918, -848, -364,
	15986, 3463, -853, -393, 15820, 4150, -867, -418, 15671, 4689, -831, -419,
	15387, 5564, -751, -411, 15094, 6318, -748, -345, 14776, 7033, -770, -222,
	14008, 8471, -674, -71, 14008, 8471, -674, -71, 13366, 9458, -579, 42,
	13025, 9919, -613, 129, 12678, 10364, -503, 173, 12229, 10898, -313, 160,
	11912, 11243, -308, 206, 11912, 11243, -308, 206, 11136, 12012, -172, 324,
	10756, 12352, -126, 406, 10446, 12612, -113, 483, 10316, 12718, -25, 522,
    10316, 12718, -25, 522, 10446, 12612, -113, 483, 10756, 12352, -126, 406,
    11136, 12012, -172, 324, 11912, 11243, -308, 206, 11912, 11243, -308, 206,
    12229, 10898, -313, 160, 12678, 10364, -503, 173, 13025, 9919, -613, 129,
    13366, 9458, -579, 42, 14008, 8471, -674, -71, 14008, 8471, -674, -71,
    14776, 7033, -770, -222, 15094, 6318, -748, -345, 15387, 5564, -751, -411,
    15671, 4689, -831, -419, 15820, 4150, -867, -418, 15986, 3463, -853, -393,
    16096, 2918, -848, -364, 16207, 2216, -856, -357, 16311, 1246, -828, -386,
    16352, 480, -799, -438, 16356, -227, -784, -486, 16320, -1092, -812, -498,
    16263, -1753, -802, -491, 16176, -2443, -749, -500, 15992, -3451, -713, -538,
    15823, -4153, -697, -588, 15608, -4891, -711, -638, 15287, -5800, -746, -739,
    15059, -6358, -756, -809, 14811, -6923, -692, -817, 14546, -7477, -507, -825,
    14385, -7786, -435, -836, 14250, -8030, -411, -847, 14079, -8328, -323, -874,
    14001, -8459, -244, -895, 13959, -8528, -217, -906, 13924, -8583, -193, -914
};
static uint8_t motion_pkt[624];

//================================================================================
//                     SAMPLING & TRANSMISSION FUNCTIONS
//================================================================================
// Read sensor and packetize data
static void sensor_work_handler(struct k_work *work)
{
	static uint8_t sample_taken[32] = {0}, packet_in_progress[MAX_PACKET_SIZE] = {0};
	static uint8_t indx_pos, temporal_sample_counter;

	/* BNO055 Register Map
	- acc  = BNO_REG_ACC_X_LSB   0x08 Acc
	- mag  = BNO_REG_MAG_X_LSB   0x0E Mag
	- gry  = BNO_REG_GYR_X_LSB   0x14 Gyr
	- eul  = BNO_REG_EUL_H_LSB   0X1A Euler angles (Heading/Roll/Pitch)
	- quat = BNO_REG_QUAT_W_LSB  0X20 Quaterniones (WXYZ)
	- lnAc = BNO_REG_LIA_X_LSB   0X28 lineal acc
	- grav = BNO_REG_GRV_X_LSB   0X2E gravity
	- temp = BNO_REG_TEMP        0X34 Temperature
	DEFAULT REGISTER VALUE = 0x80 = 10000000 = m/s2, dps, degrees, °C, Android
	*/

	// Read: Accelerometer + Magnetometer + Gyroscope + EA (not used) + Quat
	if (bno_ok) {
		bno055_read_raw_sensor_data(acc, 32, sample_taken, 0);
		// Reorder
		uint8_t temp_quat[8];
		memcpy(temp_quat, &sample_taken[24], 8);
		memmove(&sample_taken[8], &sample_taken[0], 24);
		memcpy(&sample_taken[0], temp_quat, 8);
	}

	// On startup
	if (first_cycle) {
		pkt_size = SAMPLE_SIZE * samples_x_pkt + 4;
		printk("%u, %u\n", pkt_size, samples_x_pkt);
		memset(packet_in_progress, 0, sizeof(packet_in_progress));
		n_pkt = 0;
		idx = 0;
		temporal_sample_counter = 0;
		first_cycle = false;
	}

	// Alternative -> Send stored data (quaternions)
	if (!bno_ok) {
		memcpy(sample_taken, &motion_pkt[idx], 8);
		idx = idx + 8;
		if (idx >= 624) idx = 0;
	}

	// store the sample according to the temporal counter
	// 4B offset because the Packet Number (NoPkts)
	indx_pos = temporal_sample_counter * SAMPLE_SIZE + 4;
	memcpy(&packet_in_progress[indx_pos], sample_taken, SAMPLE_SIZE);

	// Samples per packet limit reached
	if (((temporal_sample_counter + 1) % samples_x_pkt) == 0) {
		// add the NoPkt
		memcpy(packet_in_progress, &n_pkt, 4);

		// MAILBOX
		k_mutex_lock(&packet_mutex, K_FOREVER);
		memcpy(last_packet, &packet_in_progress, sizeof(packet_in_progress));
		k_mutex_unlock(&packet_mutex);
		// Pkt ready -> Semaphore give
		k_sem_give(&ble_data_sem);

		n_pkt++;
	}

	// Update counters
	temporal_sample_counter++;
	if (temporal_sample_counter == samples_x_pkt) temporal_sample_counter = 0;
}

// HW Timer ISR 
void mi_alarma_hw_callback_0(const struct device *dev, uint8_t chan_id, uint32_t ticks, void *user_data)
{
	// Rearm alarm for next period
	alarm_cfg0.ticks = ticks + ts_ticks;
	counter_set_channel_alarm(dev, chan_id, &alarm_cfg0);
	// Capture sample
	k_work_submit_to_queue(&sensor_work_q, &sensor_work);
}

// Thread for sending data periodically
void send_data_thread(void *p1, void *p2, void *p3)
{
	ARG_UNUSED(p1);
	ARG_UNUSED(p2);
	ARG_UNUSED(p3);

    uint8_t packet_to_send[MAX_PACKET_SIZE] = {0};
	uint32_t num = 0;
	int err;

    while (1) {
        // Wait for pkts
        k_sem_take(&ble_data_sem, K_FOREVER);
        // Copy latest packet from mailbox to local buffer
        k_mutex_lock(&packet_mutex, K_FOREVER);
		memcpy(packet_to_send, &last_packet, sizeof(last_packet));
        k_mutex_unlock(&packet_mutex);

		// If connected, subscribed, and TX command received
		if (ble_tx) {
			memcpy(&num, packet_to_send, sizeof(num));
			if (tx_notify) {
				err = my_imus_send_sensordata(packet_to_send, pkt_size);
				LOG_INF("N[%u][%uB]", num, pkt_size);
				if (err) LOG_WRN("Notification failed (err %d)", err);
			}
			if (tx_indicate){
				err = my_imus_send_exercisedetection(packet_to_send, pkt_size);
				LOG_INF("I[%u][%uB]", num, pkt_size);
				if (err) LOG_WRN("Indication failed (err %d)", err);
			}

			// If stop packet function is active
			if (stop_pkt > 0) {
				counter_tx++;
				if (counter_tx == stop_pkt) ble_tx = false;
			}
		}
    }
}

//================================================================================
//                            BLE FUNCTIONS
//================================================================================
// Start the advertisign in the work-queue
static void adv_work_handler(struct k_work *work)
{
	int err;
	// Address filter
	err = bt_le_filter_accept_list_add(&target_addr);
    if (err) LOG_WRN("whitelist err %d", err);
	err = bt_le_adv_start(adv_param, ad, ARRAY_SIZE(ad), sd, ARRAY_SIZE(sd));
	if (err) {LOG_ERR("Advertising failed to start (err %d)\n", err);return;}
	LOG_INF("Advertising successfully started");
}

// Function to start advertising sending the work item to the work-queue
static void advertising_start(void){k_work_submit(&adv_work);}

/************************ Connection events callback functions ************************/
// Callback function for announcing the connection or error in the connection
static void on_connected(struct bt_conn *conn, uint8_t err)
{
	if (err) {
		LOG_ERR("Connection failed (err %u)\n", err);
		return;
	}
	LOG_INF("Connected. Reading intitial parameters...");

	my_conn = bt_conn_ref(conn);
	struct bt_conn_info info;
	err = bt_conn_get_info(conn, &info);
	if (err) {
		LOG_ERR("bt_conn_get_info() returned %d", err);
		return;
	}

	// Connection parameters to the log
	double connection_interval = info.le.interval*1.25;	// in ms
	uint16_t supervision_timeout = info.le.timeout*10;	// in ms
	LOG_INF("- Connection parameters: interval %.2f ms, latency %d (CI), timeout %d ms",
			connection_interval, info.le.latency, supervision_timeout);

	// Data Length parameters to the log
	LOG_INF("- Data length: TX %d bytes / %d us, RX %d bytes / %d us",
            info.le.data_len->tx_max_len, info.le.data_len->tx_max_time,
            info.le.data_len->rx_max_len, info.le.data_len->rx_max_time);
}

//Callback function for announcing the disconnection
static void on_disconnected(struct bt_conn *conn, uint8_t reason)
{
	LOG_INF("Disconnected (reason %u)-----------\n", reason);
	bt_conn_unref(my_conn);

	// Stop time alarm
	counter_cancel_channel_alarm(hw_timer_dev, 0);
	k_sem_take(&ble_data_sem, K_NO_WAIT);
	ble_tx = false; // Tx OFF

	// Reconnection
	k_msleep(200);
	advertising_start();
}

// Callback for connection parameter update requests
static bool le_param_req(struct bt_conn *conn, struct bt_le_conn_param *param)
{LOG_INF("Connection parameters update requested by central.");return true;}

// Callback to inform the connection parameter update
void on_le_param_updated(struct bt_conn *conn, uint16_t interval, uint16_t latency, uint16_t timeout)
{
	double connection_interval = interval*1.25;         // in ms
	uint16_t supervision_timeout = timeout*10;          // in ms
	LOG_INF("Connection parameters updated: interval %.2f ms, latency %d (CI), timeout %d ms",
		connection_interval, latency, supervision_timeout);
}

// Callback to inform the update of PHY
void on_le_phy_updated(struct bt_conn *conn, struct bt_conn_le_phy_info *param)
{
	// PHY Updated
	if (param->tx_phy == BT_CONN_LE_TX_POWER_PHY_1M) {LOG_INF("PHY updated. New PHY: 1M");}
	else if (param->tx_phy == BT_CONN_LE_TX_POWER_PHY_2M) {LOG_INF("PHY updated. New PHY: 2M");}
	else if (param->tx_phy == BT_CONN_LE_TX_POWER_PHY_CODED_S8) {LOG_INF("PHY updated. New PHY: Long Range");}
}

// Callback to inform the update of data length
void on_le_data_len_updated(struct bt_conn *conn, struct bt_conn_le_data_len_info *info)
{
	uint16_t tx_len  = info->tx_max_len;
	uint16_t tx_time = info->tx_max_time;
	uint16_t rx_len  = info->rx_max_len;
	uint16_t rx_time = info->rx_max_time;
	LOG_INF("Data length updated. Length %d/%d bytes, time %d/%d us", tx_len, rx_len, tx_time, rx_time);
}

// Callback structure for connections events
struct bt_conn_cb connection_callbacks = {
	.connected				= on_connected,
	.disconnected			= on_disconnected,
	.le_param_req			= le_param_req,
	.le_param_updated		= on_le_param_updated,
	.le_phy_updated			= on_le_phy_updated,
	.le_data_len_updated    = on_le_data_len_updated,
};

//******************************************************************************************************** */
// Callback function for receiving data from the Write characteristic
static void app_command_cb(const uint8_t *buf, uint16_t len)
{
	if (len == 0) return;

	LOG_INF("Rx CMD[%02X:%uB]", buf[0], len);
	uint8_t cmd;
	cmd = buf[0];

	// Eneable-disable the tx characteristic
	if (cmd == 0x01 && len == 2) {
		if (buf[1] == 0x01) tx_notify = true;
		else tx_notify = false;
		LOG_INF("Notify %s", tx_notify ? "ON" : "OFF");
	}

	if (cmd == 0x02 && len == 2) {
		if (buf[1] == 0x01) tx_indicate = true;
		else tx_indicate = false;
		LOG_INF("Indicate %s", tx_indicate ? "ON" : "OFF");
	}

	// Star-Stop Tx
	if (cmd == 0x03 && len == 2) {
		uint32_t now_ticks;
		counter_get_value(hw_timer_dev, &now_ticks);
		if (buf[1] == 0x01) {
			ble_tx = true;
			first_cycle = true;
			counter_tx = 0;
			alarm_cfg0.ticks = now_ticks + ts_ticks;
			counter_set_channel_alarm(hw_timer_dev, 0, &alarm_cfg0);
		} else {
			ble_tx = false;
			counter_cancel_channel_alarm(hw_timer_dev, 0);
		}
		LOG_INF("%s", ble_tx ? "Start" : "Stop");
	}

	// Stop pkt
	if (cmd == 0x04 && len == 5) {
		stop_pkt = sys_get_le32(&buf[1]);
		counter_tx = 0;
		LOG_INF("Stop-TxPkt = %u", stop_pkt);
	}

	// Sampling Frecuenci (Fs)
	if (cmd == 0x05 && len == 5) {
		uint32_t n;
		n = sys_get_le32(&buf[1]);
		if (n > 0) {
			fs_hz = n;
			ts_us = (1000000 / fs_hz);
			ts_ticks = counter_us_to_ticks(hw_timer_dev, ts_us);
		}
		LOG_INF("Fs = %u", fs_hz);
	}

	// Samples X pkt
	if (cmd == 0x06 && len == 2) {
		if (buf[1] > 0) {
			samples_x_pkt = buf[1];
			first_cycle = true;
		}
		LOG_INF("Samples X pkt (SXP) = %u", samples_x_pkt);
	}
}

static struct my_imus_cb app_callbacks = {.command_write_cb = app_command_cb,};

// MAIN FUNCTION ********************************************************************
int main(void)
{
	// Pass save motion data (raw quat) to uint8 array
	uint16_t valor = 0;
	int index = 0;
	for (int i = 0; i < 312; i++) {
		valor = sys_cpu_to_le16(motion_data[i]);
		index = i * 2;
		memcpy(&motion_pkt[index], &valor, 2);
	}
	int err;
	//================================================================================
	//                                  1. LED'S
	//================================================================================
	if (!gpio_is_ready_dt(&red_led) && !gpio_is_ready_dt(&grn_led) && !gpio_is_ready_dt(&blu_led)) {
		LOG_ERR("Error led gpio\n");
		return -1;
	}
	gpio_pin_configure_dt(&red_led, GPIO_OUTPUT_ACTIVE);
	gpio_pin_configure_dt(&grn_led, GPIO_OUTPUT_ACTIVE);
	gpio_pin_configure_dt(&blu_led, GPIO_OUTPUT_ACTIVE);
	gpio_pin_set_dt(&red_led, 1);
	gpio_pin_set_dt(&grn_led, 0);
	gpio_pin_set_dt(&blu_led, 0);

	//================================================================================
	//                                 2. SENSOR
	//================================================================================
	if (!device_is_ready(i2c1_dev)) {
		LOG_ERR("I2C-1 not ready");
		return -1;
	}
	LOG_INF("Starting IMU-Node.");

	// Init the BNO and select the operation mode.
	// Note, if the NDOF mode is unstable change to IMU mode (caution in this mode mag is disable)
	if (!bno055_init(i2c1_dev, BNO_OPR_MODE_NDOF)) {
		LOG_ERR("BNO055 init failed");
	} else {
		bno_ok = true;
		LOG_INF("BNO055 init OK.");
		bno055_change_crystal(true);
		// optional load the calibrations offsets of a previus calibration
		// This can help if the fusion algorithm is unstable
		int16_t bno_cal_offsets[11] = {-3, 5, -34, 32325, -738, 10118, -1, -2, 3, 1000, 773};
		bno055_calibration_offsets(true, bno_cal_offsets);
		k_msleep(600);
		// Check tha config of BNO
		uint8_t config_values[5];
		bno055_read_config(config_values, false);
		units = config_values[3];
		// BNO Ok -> Turn off the red led
		gpio_pin_set_dt(&red_led, 0);
	}

	//================================================================================
	//                            3. DATA ACQUISITION
	//================================================================================
	// Mailbox: Mutex and Semaphore
	k_mutex_init(&packet_mutex);
	k_sem_init(&ble_data_sem, 0, 1);

	// Dedicated workqueue
	k_work_queue_start(&sensor_work_q, sensor_work_q_stack,
		K_KERNEL_STACK_SIZEOF(sensor_work_q_stack),
		K_PRIO_COOP(GETSAMPLE_PRIORITY), NULL);
	k_work_init(&sensor_work, sensor_work_handler);

	// BLE packet transmission thread
	send_thread_tid = k_thread_create(&send_thread_data, send_thread_stack, K_KERNEL_STACK_SIZEOF(send_thread_stack),
		send_data_thread, NULL, NULL, NULL, SEND_PRIORITY, 0, K_NO_WAIT);

	if (!send_thread_tid) {
		LOG_ERR("Failed to create send_data_thread");
		return -1;
	}
	k_thread_name_set(send_thread_tid, "ble_send_thread");
	
	//================================================================================
	//                               4. BLUETOOTH
	//================================================================================
	// Eneable the bluetooth stack
	err = bt_enable(NULL);
	if (err) {
		LOG_ERR("Bluetooth init failed (err %d)\n", err);
		return -1;
	}

	// Initialize the IMU service with the application callbacks
	err = my_imus_init(&app_callbacks);
	if (err) {
		LOG_ERR("Fail to init IMU Service (err %d)\n", err);
		return -1;
	}
	// Register the connections events callbacks
	bt_conn_cb_register(&connection_callbacks);
	// Initialization of the work item for advertising
	k_work_init(&adv_work, adv_work_handler);

	// Get the Bluetooth device address
	bt_addr_le_t addr;
	size_t count = 1;
	char addr_str[BT_ADDR_LE_STR_LEN];
	bt_id_get(&addr, &count);
	bt_addr_le_to_str(&addr, addr_str, sizeof(addr_str));
	LOG_INF("%s - %s [CEL=%dus]", CONFIG_BT_DEVICE_NAME, addr_str, CONFIG_BT_CTLR_SDC_MAX_CONN_EVENT_LEN_DEFAULT);

	//================================================================================
	//                                  TIMER
	//================================================================================
	const struct device *clock = DEVICE_DT_GET_ONE(nordic_nrf_clock);
    if (!device_is_ready(clock)) {
        LOG_ERR("clock not ready");
        return 0;
	}
	
    // Request HFXO (High-Frequency Crystal Oscillator)
	clock_control_on(clock, CLOCK_CONTROL_NRF_SUBSYS_HF);
	k_msleep(5);
    if (!nrf_clock_hf_is_running(NRF_CLOCK, NRF_CLOCK_HFCLK_HIGH_ACCURACY)) LOG_WRN("HFXO not set");
    // Force constant latency mode
    nrf_power_task_trigger(NRF_POWER, NRF_POWER_TASK_CONSTLAT);

	if (!device_is_ready(hw_timer_dev)) {
        LOG_ERR("Timer not ready.\n");
        return 0;
    }
	counter_start(hw_timer_dev);

	ts_us = (1000000 / fs_hz);
	ts_ticks = counter_us_to_ticks(hw_timer_dev, ts_us);
	alarm_cfg0 = (struct counter_alarm_cfg){
		.flags = COUNTER_ALARM_CFG_ABSOLUTE,
		.ticks = ts_ticks,
		.callback = mi_alarma_hw_callback_0,
		.user_data = NULL
	};

	//================================================================================
	k_msleep(500);
	advertising_start();
}
```

## src/bno055_driver.c
```c
/* Made by Miguel Angel Castro-Perez - 2025
   BNO055 library for Zephyr RTOS!
   
   For an unknown reason (and contrary to what the datasheet says)
   1. The BNO doesn't reset on power on, so you need to reset it manually.
   2. The BNO needs a "big" delay after reset to start working correctly, I recommend 800ms.
   3. The BNO needs a "big" delay after setting the external crystal, even if the system clock status is ok ... I recommend 650ms.
   To change configuration the BNO needs to be set to CONFIG MODE first
*/

#include "bno055_driver.h"
#include <zephyr/logging/log.h>
#include <zephyr/drivers/i2c.h>
#include <zephyr/sys/byteorder.h>
#include <string.h>

//==================================================================================================
// CONFIGURATION AND PRIVATE VARIABLES
//==================================================================================================
LOG_MODULE_REGISTER(BNO, LOG_LEVEL_INF);
// Static pointer to the I2C device, initialized in bno055_init
static const struct device *i2c_dev;
#define BNO_CONFIG_DELAY_MS 25 // Small delay after changing mode

//==================================================================================================
// PUBLIC FUNCTIONS IMPLEMENTATION
//==================================================================================================

bool bno055_reset(void)
{
    // CONFIG MODE -> PAGE 0 -> RESET -> CONFIG MODE -> SYS_TRIG = 0
    if (!bno055_set_config_mode()) return false;

    if (i2c_reg_write_byte(i2c_dev, BNO_DEFAULT_ADDR, BNO_REG_PAGE_ID, BNO_PAGE_0) != 0) {
        LOG_ERR("Failed to set page ID to 0.");
        return false;
    }
    
    if (i2c_reg_write_byte(i2c_dev, BNO_DEFAULT_ADDR, BNO_REG_SYS_TRIGGER, BNO_SYS_TRIGGER_RST_SYS) != 0) {
        LOG_ERR("Failed to write reset command.");
        return false;
    }
    k_msleep(800);

    if (!bno055_set_config_mode()) return false;

    if (i2c_reg_write_byte(i2c_dev, BNO_DEFAULT_ADDR, BNO_REG_SYS_TRIGGER, 0x00) != 0) {
        LOG_ERR("Failed to write reset command.");
        return false;
    }

    LOG_INF("BNO055 reset successfully.");
    return true;
}

bool bno055_init(const struct device *i2c_dev_node, uint8_t initial_op_mode)
{
    i2c_dev = i2c_dev_node; // Assign the I2C device pointer
    if (!device_is_ready(i2c_dev)) {
        LOG_ERR("I2C device not ready.");
        return false;
    }

    // DELAY TO ALLOW THE BNO TO INITIALIZE
    k_msleep(800);
    uint8_t chip_id = 0;
    if (i2c_reg_read_byte(i2c_dev, BNO_DEFAULT_ADDR, BNO_REG_CHIP_ID, &chip_id) != 0) {
        LOG_ERR("Failed to read chip ID. BNO055 not found?");
        return false;
    }

    if (chip_id != 0xA0) {
        LOG_ERR("Invalid chip ID: 0x%02X (expected 0xA0)", chip_id);
        return false;
    }
    LOG_INF("BNO055 found with chip ID 0x%02X", chip_id);

    // RESET TO CLEAR ANY PREVIOUS CONFIGURATION
    if (!bno055_reset()) {
        LOG_ERR("Initial BNO055 reset failed.");
        return false;
    }

    // Set the operation mode
    if (!bno055_change_opm(initial_op_mode)) {
        LOG_ERR("Failed to set initial operation mode.");
        return false;
    }
    
    LOG_INF("BNO055 initialized successfully in mode 0x%02X", initial_op_mode);
    return true;
}

bool bno055_read_config(uint8_t *config_values, bool print_v)
{
    uint8_t page_id, pwr_mode, opr_mode, unit_sel, sys_trigger;
    
    if (i2c_reg_read_byte(i2c_dev, BNO_DEFAULT_ADDR, BNO_REG_PAGE_ID, &page_id) != 0 ||
        i2c_reg_read_byte(i2c_dev, BNO_DEFAULT_ADDR, BNO_REG_PWR_MODE, &pwr_mode) != 0 ||
        i2c_reg_read_byte(i2c_dev, BNO_DEFAULT_ADDR, BNO_REG_OPR_MODE, &opr_mode) != 0 ||
        i2c_reg_read_byte(i2c_dev, BNO_DEFAULT_ADDR, BNO_REG_UNIT_SEL, &unit_sel) != 0 ||
        i2c_reg_read_byte(i2c_dev, BNO_DEFAULT_ADDR, BNO_REG_SYS_TRIGGER, &sys_trigger) != 0) {
        LOG_ERR("Failed to read config registers.");
        return false;
    }

    config_values[0] = page_id;
    config_values[1] = pwr_mode;
    config_values[2] = opr_mode;
    config_values[3] = unit_sel;
    config_values[4] = sys_trigger;
    
    if (print_v) printk("BNO Config: PageID=0x%02X, PwrMode=0x%02X, OprMode=0x%02X, Units=0x%02X, Trigger=0x%02X\n", page_id, pwr_mode, opr_mode, unit_sel, sys_trigger);
    return true;
}

bool bno055_calibration_status(uint8_t *cal_values)
{
    uint8_t cal_stat;
    if (i2c_reg_read_byte(i2c_dev, BNO_DEFAULT_ADDR, BNO_REG_CALIB_STAT, &cal_stat) != 0) {
        LOG_ERR("Failed to read calibration status.");
        return false;
    }
    
    cal_values[0] = (cal_stat >> 6) & 0x03; // SYS
    cal_values[1] = (cal_stat >> 4) & 0x03; // ACC
    cal_values[2] = (cal_stat >> 2) & 0x03; // GYR
    cal_values[3] = cal_stat & 0x03;        // MAG
    // cal_values[4] = cal_values[1] + cal_values[2] + cal_values[3] + cal_values[4];
    
    LOG_INF("Calibration status: SYS=%d, ACC=%d, GYR=%d, MAG=%d",
            cal_values[0], cal_values[1], cal_values[2], cal_values[3]);
    return true;
}

bool bno055_set_config_mode(void)
{
    uint8_t current_op_mode;
    if (i2c_reg_read_byte(i2c_dev, BNO_DEFAULT_ADDR, BNO_REG_OPR_MODE, &current_op_mode) != 0) {
        LOG_WRN("Could not read OPR_MODE to check if already in config mode.");
    }

    if (current_op_mode == BNO_OPR_MODE_CONFIG) {
        return true; // Already in config mode
    }

    if (i2c_reg_write_byte(i2c_dev, BNO_DEFAULT_ADDR, BNO_REG_OPR_MODE, BNO_OPR_MODE_CONFIG) != 0) {
        LOG_ERR("Failed to set config mode.");
        return false;
    }
    k_msleep(BNO_CONFIG_DELAY_MS);
    return true;
}

bool bno055_change_opm(uint8_t new_op_mode)
{
    if (!bno055_set_config_mode()) return false;

    if (i2c_reg_write_byte(i2c_dev, BNO_DEFAULT_ADDR, BNO_REG_OPR_MODE, new_op_mode) != 0) {
        LOG_ERR("Failed to set new operation mode 0x%02X", new_op_mode);
        return false;
    }
    k_msleep(BNO_CONFIG_DELAY_MS);
    return true;
}

bool bno055_calibration_offsets(bool write, int16_t *offsets)
{
    // The BNO has to be in CONFIG MODE to write or read the calibration offsets
    uint8_t current_mode;
    if (i2c_reg_read_byte(i2c_dev, BNO_DEFAULT_ADDR, BNO_REG_OPR_MODE, &current_mode) != 0) {
        LOG_WRN("Failed to read original op mode.");
        return false;
    }

    if (!bno055_set_config_mode()) return false;

    bool success = false;
    uint8_t buffer[22];
    // WRITE OFFSETS ***************************************************************************
    if (write) {
        for (int i = 0; i < 11; i++) {
            buffer[i * 2] = offsets[i] & 0xFF;
            buffer[i * 2 + 1] = (offsets[i] >> 8) & 0xFF;
        }

        if (i2c_burst_write(i2c_dev, BNO_DEFAULT_ADDR, BNO_REG_ACC_OFFSET_X_LSB, buffer, 22) == 0) {
            LOG_INF("Calibration offsets written successfully.");
            success = true;
            k_msleep(40);
        } else LOG_ERR("Failed to write calibration offsets.");

    } else { 
    
        // READ OFFSETS **************************************************************************
        if (i2c_burst_read(i2c_dev, BNO_DEFAULT_ADDR, BNO_REG_ACC_OFFSET_X_LSB, buffer, 22) == 0) {
            for (int i = 0; i < 11; i++) {
                offsets[i] = (int16_t)(((uint16_t)buffer[i * 2 + 1] << 8) | (uint16_t)buffer[i * 2]);
            }
            LOG_INF("Calibration offsets read successfully.");
            success = true;
        } else LOG_ERR("Failed to read calibration offsets.");
    }

    // Restore the original operation mode
    if (current_mode != BNO_OPR_MODE_CONFIG) bno055_change_opm(current_mode);
    return success;
}

bool bno055_change_crystal(bool set_external_crystal)
{
    uint8_t current_trigger, current_opm;
    if (i2c_reg_read_byte(i2c_dev, BNO_DEFAULT_ADDR, BNO_REG_SYS_TRIGGER, &current_trigger) != 0) return false;

    bool is_external_now = (current_trigger & BNO_SYS_TRIGGER_EXT_CRYSTAL);
    if (set_external_crystal == is_external_now) {
        LOG_INF("Crystal already in desired state.");
        return true;
    }
    
    // Read the current opm -> set to config mode
    if (i2c_reg_read_byte(i2c_dev, BNO_DEFAULT_ADDR, BNO_REG_OPR_MODE, &current_opm) != 0) return false;
    if (!bno055_set_config_mode()) return false;

    // Check if the BNO is ready to change the crystal
    uint8_t clk_ready;
    for (int i = 0; i < 10; i++) {
        i2c_reg_read_byte(i2c_dev, BNO_DEFAULT_ADDR, 0x38, &clk_ready); // 0x38 = system clock status register
        if (clk_ready & 0x01) k_msleep(100);	// bit0=1, BNO not ready to change the crystal
        else break;								// bit0=0, BNO ready to change the crystal
    }

    // CHANGE CRYSTAL SOURCE **************************************************
    uint8_t new_trigger_val = set_external_crystal ? BNO_SYS_TRIGGER_EXT_CRYSTAL : 0x00;
    if (i2c_reg_write_byte(i2c_dev, BNO_DEFAULT_ADDR, BNO_REG_SYS_TRIGGER, new_trigger_val) != 0) {
        LOG_ERR("Failed to write to SYS_TRIGGER register.");
        return false;
    }
    k_msleep(650);  // Delay to allow the BNO to change the crystal

    // Check if the BNO finished the crystal configuration
    for (int i = 0; i < 10; i++) {
        i2c_reg_read_byte(i2c_dev, BNO_DEFAULT_ADDR, 0x38, &clk_ready);
        if (clk_ready & 0x01) k_msleep(100);	// bit0=1, BNO not ready
        else break;								// bit0=0, BNO ready
    }

    // Verify the crystal state after changing it
    i2c_reg_read_byte(i2c_dev, BNO_DEFAULT_ADDR, BNO_REG_SYS_TRIGGER, &current_trigger);
    if (new_trigger_val != current_trigger) {
        LOG_ERR("Failed to change crystal");
        if (current_opm != BNO_OPR_MODE_CONFIG) bno055_change_opm(current_opm);
        return false;
    }
    
    LOG_INF("Crystal = 0x%02X (%s)", current_trigger, set_external_crystal ? "external" : "internal");
    // Restore the original operation mode
    if (current_opm != BNO_OPR_MODE_CONFIG) bno055_change_opm(current_opm);
    return true;
}

bool bno055_read_raw_sensor_data(uint8_t start_register, uint8_t bytes_to_read, uint8_t *buffer, uint8_t start_index)
{
    if (i2c_burst_read(i2c_dev, BNO_DEFAULT_ADDR, start_register, &buffer[start_index], bytes_to_read) != 0) {
        LOG_WRN("Failed to read %d bytes from register 0x%02X", bytes_to_read, start_register);
        return false;
    }
    return true;
}

bool bno055_convert_to_units(const uint8_t *in_buffer, uint8_t in_buff_index, float *out_buffer, uint8_t out_buff_index, uint8_t sensor_source, uint8_t units)
{
    float div = 1.0f;
    int stop = 3; // 3 axes (X,Y,Z) by default

    switch (sensor_source) {
        case BNO_REG_LIA:
        case BNO_REG_GRV:
        case BNO_REG_ACC:
            if (units & 0x01)   div = 1.0f;     // mg
            else                div = 100.0f;   // m/s^2
            break;
        case BNO_REG_GYR: 
            if (units & 0x02)   div = 900.0f;   // rps
            else                div = 16.0f;    // dps
            break;
        case BNO_REG_MAG: div = 16.0f; break;  // uT
        case BNO_REG_EUL:
            if (units & 0x04)   div = 900.0f;   // rad
            else                div = 16.0f;    // deg
            break;
        case BNO_REG_QUAT:
            div = 16384.0f;
            stop = 4; // W,X,Y,Z
            break;
        case BNO_REG_TEMP:
            div = 1.0f; // 1 LSB = 1 C
            stop = 1;
            break;
        default:
            LOG_WRN("Unknown sensor source for unit conversion: 0x%02X", sensor_source);
            return false;
    }
    
    for (int i = 0; i < stop; i++) {
        int16_t raw_val = (int16_t)sys_get_le16(&in_buffer[in_buff_index + i * 2]);
        out_buffer[out_buff_index + i] = (float)raw_val / div;
    }
    
    return true;
}
```

## src/bno055_driver.h
```c
/* 
Made by Miguel Angel Castro-Perez- 2025! 
BNO055 library for Zephyr RTOS!
*/

#ifndef BNO055_DRIVER_H_
#define BNO055_DRIVER_H_

#ifdef __cplusplus
extern "C" {
#endif

#include <zephyr/kernel.h>
#include <zephyr/device.h>
#include <stdbool.h>

//==================================================================================================
// BNO055 REGISTERS - Public
//==================================================================================================
#define BNO_DEFAULT_ADDR    0x28    //0x28 or 0x29
#define BNO_REG_CHIP_ID     0x00
#define BNO_REG_PAGE_ID     0x07

// Page 0
#define BNO_PAGE_0			    0x00
#define BNO_REG_SYS_TRIGGER	    0x3F
#define BNO_SYS_TRIGGER_RST_SYS	0x20
#define BNO_SYS_TRIGGER_EXT_CRYSTAL	0x80
#define BNO_REG_PWR_MODE	    0x3E
#define BNO_PWR_MODE_NORMAL		0x00
#define BNO_REG_OPR_MODE	    0x3D
#define BNO_OPR_MODE_CONFIG		0x00
#define BNO_OPR_MODE_AMG		0x07
#define BNO_OPR_MODE_IMU		0x08
#define BNO_OPR_MODE_NDOF		0x0C
#define BNO_REG_CALIB_STAT	    0x35
#define BNO_REG_UNIT_SEL 	    0x3B

// Sensor Data Registers (Page 0)
#define BNO_REG_ACC   0X08
#define BNO_REG_GYR   0X14
#define BNO_REG_MAG   0X0E
#define BNO_REG_EUL   0X1A
#define BNO_REG_QUAT  0X20
#define BNO_REG_LIA   0X28
#define BNO_REG_GRV   0X2E
#define BNO_REG_TEMP  0X34

// Sensor Data Registers (Short Name)
#define acc     BNO_REG_ACC
#define gyr     BNO_REG_GYR
#define mag     BNO_REG_MAG
#define eul     BNO_REG_EUL
#define quat    BNO_REG_QUAT
#define lnAc    BNO_REG_LIA
#define grav    BNO_REG_GRV
#define temp    BNO_REG_TEMP

// Page 1
#define BNO_PAGE_1         0x01
#define BNO_REG_ACC_CONF	0x08	// Acc Configuration, Default 0x38 [00111000]=4G,62.5Hz,NM
#define BNO_REG_GYR_CONF_0	0x0A	// Gyr Configuration, Default 0x38 [00111000]
#define BNO_REG_GYR_CONF_1	0x0B	// Gyr Configuration, Default 0x00 [00000000]=2000dps,32Hz,NM
#define BNO_REG_MAG_CONF	0x09	// Mag Configuration, Default 0x0B [00001011]=10Hz,Regular,NM
#define BNO_REG_ACC_OFFSET_X_LSB	0x55

//==================================================================================================
// PUBLIC API FUNCTIONS
//==================================================================================================

/**
 * @brief Initializes the I2C bus, resets the BNO055 and configures it in an operation mode.
 * @param i2c_dev_node Device Tree node for the I2C bus (e.g. DT_NODELABEL(i2c1)).
 * @param initial_op_mode The initial operation mode (e.g. BNO_OPR_MODE_NDOF).
 * @return true if initialization was successful.
 */
bool bno055_init(const struct device *i2c_dev_node, uint8_t initial_op_mode);

/**
 * @brief Reads, saves and prints the basic configuration registers of the BNO055.
 * @param config_values Pointer to a 5-byte array where the configuration values will be stored. [Page ID, Power Mode, Operation mode, Unit Selection, System Trigger].
 * @param print_v True to print the values.
 * @return true if the read was successful, false on error.
 */
bool bno055_read_config(uint8_t *config_values, bool print_v);

/**
 * @brief Reads the calibration status of the BNO055.
 * @param cal_values Pointer to a 4-byte array where the calibration states will be stored [SYS, GYR, ACC, MAG].
 * @return true if the read was successful, false on error.
 */
bool bno055_calibration_status(uint8_t *cal_values);

/**
 * @brief Sets the BNO055 into configuration mode.
 * @return true if the operation was successful, false on error.
 */
bool bno055_set_config_mode(void);

/**
 * @brief Changes the operation mode of the BNO055.
 * @param new_op_mode The new operation mode (e.g. BNO_OPR_MODE_IMU).
 * @return true if the operation was successful, false on error.
 */
bool bno055_change_opm(uint8_t new_op_mode);

/**
 * @brief Reads or writes the calibration offsets of the BNO055.
 * @param write If true, writes the offsets to the BNO055. If false, reads them.
 * @param offsets Pointer to an array of 11 int16_t for the offset data. [Axyz, Mxyz, Gxyz, AccRad, MagRad].
 * @return true if the operation was successful, false on error.
 */
bool bno055_calibration_offsets(bool write, int16_t *offsets);

/**
 * @brief Changes the clock source of the BNO055 between internal and external crystal.
 * @param set_external_crystal If true, uses the external crystal. If false, uses the internal one.
 * @return true if the operation was successful, false on error.
 */
bool bno055_change_crystal(bool set_external_crystal);

/**
 * @brief Performs a system reset on the BNO055.
 * @return true if the operation was successful, false on error.
 */
bool bno055_reset(void);

/**
 * @brief Reads raw data from a starting register of the BNO055.
 * @param start_register Starting register to read from.
 * @param bytes_to_read Number of bytes to read.
 * @param buffer Pointer to the buffer where the data will be stored.
 * @param start_index Buffer index where storing should begin.
 * @return true if the read was successful, false on error.
 */
bool bno055_read_raw_sensor_data(uint8_t start_register, uint8_t bytes_to_read, uint8_t *buffer, uint8_t start_index);

/**
 * @brief Converts raw data to their corresponding units.
 * @param in_buffer Buffer containing the raw data.
 * @param in_buff_index Start index in the input buffer.
 * @param out_buffer Buffer for the converted data (float).
 * @param out_buff_index Start index in the output buffer.
 * @param sensor_source Sensor|Register source of the data. Acc|LnAcc|Grav = acc.
 * @param units Value of the Select_Unit register (0x3B).
 * @return true if the conversion was valid, false otherwise.
 */
bool bno055_convert_to_units(const uint8_t *in_buffer, uint8_t in_buff_index, float *out_buffer, uint8_t out_buff_index, uint8_t sensor_source, uint8_t units);


#ifdef __cplusplus
}
#endif

#endif /* BNO055_DRIVER_H_ */
```

## src/my_imu_ble_service.c
```c
/** @file
 *  @brief IMU Service (IMUS)
 */

#include <zephyr/types.h>
#include <stddef.h>
#include <string.h>
#include <errno.h>
#include <zephyr/sys/printk.h>
#include <zephyr/sys/byteorder.h>
#include <zephyr/kernel.h>
#include <zephyr/logging/log.h>
#include <zephyr/bluetooth/bluetooth.h>
#include <zephyr/bluetooth/hci.h>
#include <zephyr/bluetooth/conn.h>
#include <zephyr/bluetooth/uuid.h>
#include <zephyr/bluetooth/gatt.h>
#include <bluetooth/gatt_dm.h> 
#include "my_imu_ble_service.h"

LOG_MODULE_REGISTER(my_imus, LOG_LEVEL_INF);

// =============================================================================
// PERIPHERAL ROLE IMPLEMENTATION
// =============================================================================
#ifdef CONFIG_BT_PERIPHERAL

// --- Internal state variables ---
static bool sensordata_notify_enabled = false;
static bool exercisedetection_indicate_enabled = false;
static struct my_imus_cb imus_cb;

// --- Internal GATT callbacks ---

static void ccc_sensordata_cfg_changed(const struct bt_gatt_attr *attr, uint16_t value)
{
	sensordata_notify_enabled = (value == BT_GATT_CCC_NOTIFY);
	LOG_INF("Subscription to SensorData %s", sensordata_notify_enabled ? "enable" : "disable");
}

static void ccc_exercisedetection_cfg_changed(const struct bt_gatt_attr *attr, uint16_t value)
{
	exercisedetection_indicate_enabled = (value == BT_GATT_CCC_INDICATE);
	LOG_INF("Subscription to ExerciseDetection %s", exercisedetection_indicate_enabled ? "enable" : "disable");
}

static ssize_t write_command_cb(struct bt_conn *conn, const struct bt_gatt_attr *attr,
								const void *buf, uint16_t len, uint16_t offset, uint8_t flags)
{
	if (imus_cb.command_write_cb) {
		imus_cb.command_write_cb(buf, len);
		return len;
	}
	return BT_GATT_ERR(BT_ATT_ERR_WRITE_NOT_PERMITTED);
}

static void indicate_cb(struct bt_conn *conn, struct bt_gatt_indicate_params *params, uint8_t err)
{if (err != 0) LOG_WRN("ExerciseDetection indication failed (err %u)", err);}

/*
 * IMU Service Declaration (Order: SensorData, ExerciseDetection, Command)
 */
BT_GATT_SERVICE_DEFINE(
	// Atributes of the IMU Service
	// attrs[0]: IMU Service declaration.
	// attrs[1]: SensorData Characteristic declaration.
	// attrs[2]: CCCD of SensorData.
	// attrs[3]: Exercise Detection declaration.
	// attrs[4]: Value of Exercise Detection (Write and Indicate operations).
	// attrs[5]: CCCD of Exercise Detection.
	// attrs[6]: Command

	my_imus_svc,BT_GATT_PRIMARY_SERVICE(BT_UUID_IMUS),
	
	/* Characteristic 1: SensorData (Streaming) */
	BT_GATT_CHARACTERISTIC(BT_UUID_IMUS_DATA, BT_GATT_CHRC_NOTIFY,
						BT_GATT_PERM_NONE, NULL, NULL, NULL),
	BT_GATT_CCC(ccc_sensordata_cfg_changed, BT_GATT_PERM_READ | BT_GATT_PERM_WRITE),

	/* Characteristic 2: ExerciseDetection (Events) */
	BT_GATT_CHARACTERISTIC(BT_UUID_IMUS_EXDETECTION, BT_GATT_CHRC_INDICATE,
						BT_GATT_PERM_NONE, NULL, NULL, NULL),
	BT_GATT_CCC(ccc_exercisedetection_cfg_changed, BT_GATT_PERM_READ | BT_GATT_PERM_WRITE),

	/* Characteristic 3: Command (Control) */
	BT_GATT_CHARACTERISTIC(BT_UUID_IMUS_COMMAND, BT_GATT_CHRC_WRITE,
						BT_GATT_PERM_WRITE, NULL, write_command_cb, NULL)
);

// --- Public API for Peripheral ---
int my_imus_init(struct my_imus_cb *callbacks)
{
	if (callbacks) {
		imus_cb.command_write_cb = callbacks->command_write_cb;
	}
	return 0;
}

int my_imus_send_sensordata(const uint8_t *data, uint16_t len)
{
	if (!sensordata_notify_enabled) {
		return -EACCES;
	}
	// SensorData attribute: Index 1
	return bt_gatt_notify(NULL, &my_imus_svc.attrs[1], data, len);
}

bool is_sensordata_notify_enabled(void)
{return sensordata_notify_enabled;}

int my_imus_send_exercisedetection(const uint8_t *data, uint16_t len)
{
	if (!exercisedetection_indicate_enabled) {
		return -EACCES;
	}
	// ExerciseDetection attribute: Index 4
	static struct bt_gatt_indicate_params ind_params;
	ind_params.attr = &my_imus_svc.attrs[4];
	ind_params.func = indicate_cb;
	ind_params.data = data;
	ind_params.len = len;

	return bt_gatt_indicate(NULL, &ind_params);
}

bool is_exercisedetection_indicate_enabled(void)
{return exercisedetection_indicate_enabled;}

#endif // CONFIG_BT_PERIPHERAL


// =============================================================================
// CENTRAL ROLE IMPLEMENTATION
// =============================================================================
#ifdef CONFIG_BT_CENTRAL

int my_imus_handles_assign(struct bt_gatt_dm *dm, struct bt_imus_client *client)
{
	const struct bt_gatt_dm_attr *chrc_attr, *ccc_attr;

	// --- characteristic 1: SensorData ---
	chrc_attr = bt_gatt_dm_char_by_uuid(dm, BT_UUID_IMUS_DATA);
	if (!chrc_attr) {
		LOG_ERR("SensorData characteristic not found.");
		return -ENOTSUP;
	}
	// The VALUE handle is the declaration handle + 1
	client->sensordata_handle = chrc_attr->handle + 1;

	ccc_attr = bt_gatt_dm_desc_by_uuid(dm, chrc_attr, BT_UUID_GATT_CCC);
	if (!ccc_attr) {
		LOG_ERR("SensorData CCCD not found.");
		return -ENOTSUP;
	}
	client->sensordata_ccc_handle = ccc_attr->handle;

	// --- characteristic 2: ExerciseDetection ---
	chrc_attr = bt_gatt_dm_char_by_uuid(dm, BT_UUID_IMUS_EXDETECTION);
	if (!chrc_attr) {
		LOG_ERR("ExerciseDetection characteristic not found.");
		return -ENOTSUP;
	}
	// The VALUE handle is the declaration handle + 1
	client->exercisedetection_handle = chrc_attr->handle + 1;

	ccc_attr = bt_gatt_dm_desc_by_uuid(dm, chrc_attr, BT_UUID_GATT_CCC);
	if (!ccc_attr) {
		LOG_ERR("ExerciseDetection CCCD not found.");
		return -ENOTSUP;
	}
	client->exercisedetection_ccc_handle = ccc_attr->handle;

	// --- characteristic 3: Command ---
	chrc_attr = bt_gatt_dm_char_by_uuid(dm, BT_UUID_IMUS_COMMAND);
	if (!chrc_attr) {
		LOG_ERR("Command characteristic not found.");
		return -ENOTSUP;
	}
	// The VALUE handle is the declaration handle + 1
	client->command_handle = chrc_attr->handle + 1;
	return 0;
}

int my_imus_subscribe_sensordata(struct bt_conn *conn, struct bt_imus_client *client, bt_gatt_notify_func_t func)
{
	client->sub_params_sensordata.notify = func;
	client->sub_params_sensordata.value = BT_GATT_CCC_NOTIFY;
	client->sub_params_sensordata.value_handle = client->sensordata_handle;
	client->sub_params_sensordata.ccc_handle = client->sensordata_ccc_handle;
	// atomic_set_bit(client->sub_params_sensordata.flags, BT_GATT_SUBSCRIBE_FLAG_VOLATILE);
	return bt_gatt_subscribe(conn, &client->sub_params_sensordata);
}

int my_imus_subscribe_exercisedetection(struct bt_conn *conn, struct bt_imus_client *client, bt_gatt_notify_func_t func)
{
	client->sub_params_exercisedetection.notify = func;
	client->sub_params_exercisedetection.value = BT_GATT_CCC_INDICATE;
	client->sub_params_exercisedetection.value_handle = client->exercisedetection_handle;
	client->sub_params_exercisedetection.ccc_handle = client->exercisedetection_ccc_handle;
	// atomic_set_bit(client->sub_params_exercisedetection.flags, BT_GATT_SUBSCRIBE_FLAG_VOLATILE);
	return bt_gatt_subscribe(conn, &client->sub_params_exercisedetection);
}

int my_imus_write_command(struct bt_conn *conn, struct bt_imus_client *client, const uint8_t *cmd, uint16_t len, bt_gatt_write_func_t cb)
{
	// static struct bt_gatt_write_params write_params;
	client->write_params.func = cb;
	client->write_params.handle = client->command_handle;
	client->write_params.offset = 0;
	client->write_params.data = cmd;
	client->write_params.length = len;
	return bt_gatt_write(conn, &client->write_params);
}

#endif // CONFIG_BT_CENTRAL
```
