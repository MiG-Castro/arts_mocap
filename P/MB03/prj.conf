## CMakeLists.txt
```
cmake_minimum_required(VERSION 3.20.0)

find_package(Zephyr REQUIRED HINTS $ENV{ZEPHYR_BASE})
project(IMU_Node_vMailbox03)

# NORDIC SDK APP START
target_sources(app PRIVATE
  src/main.c
  src/my_imu_ble_service.c
  src/bno055_driver.c
)

# NORDIC SDK APP END
zephyr_library_include_directories(.)
```

## prj.conf
```kconfig
# --- Logging ---
CONFIG_LOG=y
# CONFIG_BT_LOG_LEVEL_ERR=y
CONFIG_BT_SMP_LOG_LEVEL_DBG=y
CONFIG_LOG_MODE_IMMEDIATE=y
CONFIG_LOG_BACKEND_UART=y

# --- Kernel y Stacks ---
# Tamaños generosos para empezar
CONFIG_BT_RX_STACK_SIZE=2048
CONFIG_MAIN_STACK_SIZE=4096
CONFIG_SYSTEM_WORKQUEUE_STACK_SIZE=2048
CONFIG_ISR_STACK_SIZE=2048

# --- Drivers ---
CONFIG_GPIO=y
CONFIG_I2C=y
CONFIG_FPU=y

# --- Bluetooth ---
CONFIG_BT=y
CONFIG_BT_PERIPHERAL=y
CONFIG_BT_DEVICE_NAME="IMU_OK"

# Configuración de conexión
CONFIG_BT_GATT_CLIENT=y # Necesario para que el periférico inicie actualizaciones
CONFIG_BT_GAP_AUTO_UPDATE_CONN_PARAMS=y
CONFIG_BT_PERIPHERAL_PREF_MAX_INT=6
CONFIG_BT_PERIPHERAL_PREF_MIN_INT=6
CONFIG_BT_PERIPHERAL_PREF_LATENCY=0
CONFIG_BT_PERIPHERAL_PREF_TIMEOUT=400

# Buffers y MTU
CONFIG_BT_USER_DATA_LEN_UPDATE=y
CONFIG_BT_USER_PHY_UPDATE=y
CONFIG_BT_CTLR_DATA_LENGTH_MAX=251
CONFIG_BT_BUF_ACL_RX_SIZE=251
CONFIG_BT_BUF_ACL_TX_SIZE=251
CONFIG_BT_L2CAP_TX_MTU=247

CONFIG_BT_SMP=y
CONFIG_BT_BONDABLE=y
CONFIG_BT_SETTINGS=y
CONFIG_SETTINGS=y
CONFIG_FLASH_PAGE_LAYOUT=y
CONFIG_FLASH_MAP=y
CONFIG_NVS=y
CONFIG_BT_SMP_SC_ONLY=n

# Habilita el Security Manager Protocol (necesario para emparejamiento)
# CONFIG_BT_SMP=y
# CONFIG_BT_GATT_AUTO_SEC_REQ=n

# --- Seguridad (Bonding) y Almacenamiento ---
# Permite que el dispositivo guarde las claves de emparejamiento (bonding)
# CONFIG_BT_BONDABLE=y
# CONFIG_BT_BONDING_REQUIRED=y
# CONFIG_BT_SMP_SC_ONLY=y
# CONFIG_BT_SMP_MIN_ENC_KEY_SIZE=16
# # Habilita que el stack de Bluetooth use el subsistema de Settings para guardar las claves
# CONFIG_BT_SETTINGS=y
# # Habilita el subsistema general de Settings
# CONFIG_SETTINGS=y 
# # Habilita el backend de almacenamiento en Flash (NVS)
# CONFIG_FLASH=y
# CONFIG_FLASH_PAGE_LAYOUT=y
# CONFIG_FLASH_MAP=y
# CONFIG_NVS=y
# # Habilita el soporte para el caché de la base de datos GATT (Database Hash)
# CONFIG_BT_GATT_CACHING=y
```

## src/main.c
```c
/*
Hecho por MC. Miguel! - 2025
Implementacion de servidor BLE. Lee datos del BNO (I2C) -> Transmite por BLE.
ENVIA UN PAQUETE CON NO.SEC + QUAT + ACC + GYR + QUAT + ACC + GYR
PERIFERICO ADOPTA UN ROL PASIVO Y SIGUE LAS INSTRUCCIONES DEL CENTRAL
COMUNICACION ENCRYPTADA - PARA SU USO SOLO CON NRF52840 DONGLE

1. Muestreo del Sensor 
   - Temporizador del kernel a 60 Hz. 
   - La lectura se delega a una cola de trabajo (work queue) dedicada.
2. Empaquetado de Datos
   - Agrupa dos muestras consecutivas CUATERNION + ACC + GYR + número de secuencia en un único paquete de datos.
3. Transmisión BLE
   - Anuncia el dispositivo como un periférico BLE conectable.
   - Una vez que un dispositivo central se conecta, los paquetes de datos se envían mediante notificaciones GATT.
   - El inicio y stop del muestreo y envió se controlan de forma remota escribiendo un comando en la característica Exercise Detection.
     - 0xAA = Inicio.
     - 0xFF = Stop.
4. Sincronización y Concurrencia
   - Usa un semáforo para notificar al hilo de envío de BLE cuándo hay un nuevo paquete listo.
   - Mutex para proteger el búfer de datos compartido contra accesos concurrentes.
5. Gestión y Feedback
   - ACEPTA CAMBIO DE PARAMETROS DE CONEXION SOLICITADOS POR EL CENTRAL
   - LED rojo encendido = inicializaciones en proceso
   - LED's parpadeando en verde = Esperando conexión a central
   - LED's parpadeando en azul = Conectado a central
*/

#include <zephyr/kernel.h>
#include <zephyr/logging/log.h>
#include <zephyr/bluetooth/bluetooth.h>
#include <zephyr/bluetooth/gap.h>
#include <zephyr/bluetooth/uuid.h>
#include <zephyr/bluetooth/conn.h>
#include <zephyr/bluetooth/addr.h>
#include <zephyr/bluetooth/gatt.h>
#include <zephyr/drivers/gpio.h>
#include <zephyr/drivers/i2c.h>
#include <zephyr/settings/settings.h>

// Include the custom IMU BLE service & BNO driver
#include "my_imu_ble_service.h"
#include "bno055_driver.h"

LOG_MODULE_REGISTER(IMU_server, LOG_LEVEL_INF);

//================================================================================
//                                LED configuration
//================================================================================
#define LED0_NODE DT_ALIAS(led0)
#define LED1_NODE DT_ALIAS(led1)
#define LED2_NODE DT_ALIAS(led2)
static const struct gpio_dt_spec red_led = GPIO_DT_SPEC_GET(LED0_NODE, gpios);
static const struct gpio_dt_spec grn_led = GPIO_DT_SPEC_GET(LED1_NODE, gpios);
static const struct gpio_dt_spec blu_led = GPIO_DT_SPEC_GET(LED2_NODE, gpios);

//================================================================================
//                                BLE configuration
//================================================================================
// Flags to know the status "update" of: PHY, Data Length and Connection Parameters
static bool connect = false;				// Dispositivo conectado?

#define DEVICE_NAME CONFIG_BT_DEVICE_NAME	// Device Bluetooth name defined in prj.conf
#define DEVICE_NAME_LEN (sizeof(DEVICE_NAME) - 1)
struct bt_conn *my_conn = NULL;

/***** Advertising parameters strcture *****/
// Small advertising interval for fast connection
static const struct bt_le_adv_param *adv_param = BT_LE_ADV_PARAM(
	(BT_LE_ADV_OPT_CONN |			// Connectable advertising
	BT_LE_ADV_OPT_USE_IDENTITY), 	// Use identity address (Static random address)
	BT_GAP_ADV_FAST_INT_MIN_1,		/* Min Advertising Interval = Value x 0.625ms = 30ms */
	BT_GAP_ADV_FAST_INT_MAX_1,		/* Max Advertising Interval = Value x 0.625ms = 60ms */
	NULL); /* Address of peer, Set to NULL for undirected advertising */

// Definition of advertising data
static const struct bt_data ad[] = {
	// General advertising & No compatible with BR/EDR (Bluetooth Classic)
	BT_DATA_BYTES(BT_DATA_FLAGS, (BT_LE_AD_GENERAL | BT_LE_AD_NO_BREDR)),
	BT_DATA(BT_DATA_NAME_COMPLETE, DEVICE_NAME, DEVICE_NAME_LEN), // Use complete name
};

static struct k_work adv_restart_work;
// Scan Response -> UUID of LBS Service
static const struct bt_data sd[] = {BT_DATA_BYTES(BT_DATA_UUID128_ALL, BT_UUID_IMUS_VAL),};

//================================================================================
//                              SENSOR y MUESTREO
//================================================================================
// Hilo para enviar el paquete por BLE
#define SEND_STACKSIZE		4096 
#define SEND_PRIORITY		8
// Hilo para muestrear y formar el paquete
#define GETSAMPLE_STACKSIZE	4096
#define GETSAMPLE_PRIORITY	7

#define SAMPLING_RATE_HZ 60
#define SAMPLING_PERIOD_US (1000000 / SAMPLING_RATE_HZ)
#define START_DELAY_MS 8000	// Delay before starting the sampling

#define I2C_NODE DT_NODELABEL(i2c1)
static const struct device *i2c1_dev = DEVICE_DT_GET(I2C_NODE);
static uint8_t units; // Store the unit configuration of BNO

// Estructura para muestra -> paquete a transmitir
// Total bytes for 2 x (A + G + M + Q) + NoPkt = 56
// Total bytes for 2 x (A + G + Q) + NoPkt =     44
# define PACKET_SIZE 44
static uint8_t last_packet[PACKET_SIZE];	// Unico buffer
static uint32_t packet_counter = 0;
static bool first_sample_taken = false;
static bool start_send = false;

/*** Recursos del Kernel para el manejo del sensor ***/
// 1. Temporizador
static struct k_timer sensor_timer;

// 2. Cola de trabajo dedicada para leer el sensor fuera de la ISR
static struct k_work_q sensor_work_q;
static struct k_work sensor_work;

// 3. Mailbox
static struct k_mutex packet_mutex;		// Mutex
static struct k_sem ble_data_sem;		// Semaforo

// NUEVAS DECLARACIONES
K_KERNEL_STACK_MEMBER(sensor_work_q_stack, GETSAMPLE_STACKSIZE); // Stack para la work queue
K_KERNEL_STACK_MEMBER(send_thread_stack, SEND_STACKSIZE);       // Stack para el hilo de envío

static struct k_thread send_thread_data; // Estructura de datos del hilo
k_tid_t send_thread_tid;                 // ID del hilo

//================================================================================
//                         FUNCIONES MUESTREO Y ENVIO
//================================================================================
// Función leer sensor y empaquetar datos
static void sensor_work_handler(struct k_work *work)
{
	if (!start_send) {
		return;
	}
	static uint8_t packet_in_progress[PACKET_SIZE];

	if (!first_sample_taken) {
		// Primera muestra
		// Guardamos el numero de paquete
		memcpy(packet_in_progress, &packet_counter, sizeof(packet_counter));
		// Guardamos datos quat + acc + gyr
		bno055_read_raw_sensor_data(quat, 8, packet_in_progress, 4);
		bno055_read_raw_sensor_data(acc, 12, packet_in_progress, 12);

		first_sample_taken = true;
	} else {
		// Segunda muestra
		bno055_read_raw_sensor_data(quat, 8, packet_in_progress, 24);
		bno055_read_raw_sensor_data(acc, 12, packet_in_progress, 32);
		
		// LÓGICA DEL MAILBOX
		// Bloquear el mutex para acceder de forma segura al mailbox
		k_mutex_lock(&packet_mutex, K_FOREVER);
		// Sobrescribir el mailbox con el paquete más reciente
		memcpy(last_packet, &packet_in_progress, sizeof(packet_in_progress));
		// Desbloquear el mutex
		k_mutex_unlock(&packet_mutex);
		// Señalizar al hilo BLE que hay nuevos datos listos
		k_sem_give(&ble_data_sem);

		// Incremento del numero de paquete
		packet_counter++;
		// Reseteamos para la siguiente pareja de muestras
		first_sample_taken = false;
	}
}

// ISR del temporizador: solo envía el trabajo a la cola
static void timer_expiry_function(struct k_timer *timer_id)
{k_work_submit_to_queue(&sensor_work_q, &sensor_work);}

// Thread for sending data periodically
void send_data_thread(void *p1, void *p2, void *p3)
{
	// ARG_UNUSED se usa para decirle al compilador que es intencional
	// que no usemos estos parámetros. Esto evita warnings de "unused variable".
	ARG_UNUSED(p1);
	ARG_UNUSED(p2);
	ARG_UNUSED(p3);
    uint8_t packet_to_send[PACKET_SIZE];

	uint8_t k = {0};

    while (1) {
        // // 1. Esperar a la señal del semaforo. El hilo dormirá aquí sin consumir CPU.
        // k_sem_take(&ble_data_sem, K_FOREVER);

        // // 2. Una vez despierto, copiar el paquete más reciente del mailbox a un búfer local.
        // //    Mutex para garantizar la integridad de los datos.
        // k_mutex_lock(&packet_mutex, K_FOREVER);
		// memcpy(packet_to_send, &last_packet, sizeof(last_packet));
        // k_mutex_unlock(&packet_mutex);

        // 3. Si estamos conectados, suscritos y recibimos el comando
		// if (connect && get_imus_sensordata_notify_enabled()) { //  && start_send
        if (get_imus_sensordata_notify_enabled() && start_send) {
            // my_imus_sensordata_notify(packet_to_send, sizeof(packet_to_send));
			my_imus_sensordata_notify(&k, 1);
			k++;
			k_msleep(1000);
        }
    }
}

//================================================================================
//                                  FUNCIONES BLE
//================================================================================
// Función dedicada para iniciar el advertising.
static void start_advertising(void)
{
	int err = bt_le_adv_start(adv_param, ad, ARRAY_SIZE(ad), sd, ARRAY_SIZE(sd));
	if (err) {
		LOG_ERR("Advertising failed to start (err %d)", err);
	} else {
		LOG_INF("Advertising successfully started.");
	}
}

// Handler para este work item. Su única tarea es llamar a start_advertising.
static void adv_restart_work_handler(struct k_work *work){start_advertising();}

/************************ Connection events callback functions ************************/
// Callback para saber cuándo se completó el cambio de seguridad
static void security_changed(struct bt_conn *conn, bt_security_t level, enum bt_security_err err)
{
    if (!err) {
        LOG_INF("Link secured. Level %u.", level);
    } else {
        LOG_ERR("Security failed. Level %u, err %d.", level, err);
    }
}

// Callback function for announcing the connection or error in the connection
static void on_connected(struct bt_conn *conn, uint8_t err)
{
	if (err) {
		LOG_ERR("Connection failed (err %u)\n", err);
		return;
	}

	connect = true;
	LOG_INF("Connected. Reading intitial parameters...");

	my_conn = bt_conn_ref(conn);
	struct bt_conn_info info;
	err = bt_conn_get_info(conn, &info);
	if (err) {
		LOG_ERR("bt_conn_get_info() returned %d", err);
		return;
	}

	// Connection parameters to the log
	double connection_interval = info.le.interval*1.25;	// in ms
	uint16_t supervision_timeout = info.le.timeout*10;	// in ms
	LOG_INF("- Connection parameters: interval %.2f ms, latency %d intervals, timeout %d ms", 
			connection_interval, info.le.latency, supervision_timeout);
	
	// Data Length parameters to the log
	LOG_INF("- Data length: TX %d bytes / %d us, RX %d bytes / %d us",
            info.le.data_len->tx_max_len, info.le.data_len->tx_max_time,
            info.le.data_len->rx_max_len, info.le.data_len->rx_max_time);
}

//Callback function for announcing the disconnection
static void on_disconnected(struct bt_conn *conn, uint8_t reason)
{
	LOG_INF("Disconnected (reason %u)\n", reason);
	bt_conn_unref(my_conn);

	// Reset the connected flag
	connect = false; 
	// Detener muestreo en desconexión
	k_timer_stop(&sensor_timer);
	start_send = false;
}

// Callback function for when a connection object is recycled (restart advertising)
static void recycled_cb(void)
{
	LOG_INF("Disconnect complete. Restart advertising\n");
	k_work_submit(&adv_restart_work);
}

// Callback para las solicitudes de cambios en los parametros de conexion
static bool le_param_req(struct bt_conn *conn, struct bt_le_conn_param *param)
{
	LOG_INF("Connection parameters update requested by central.");
	// Simplemente acepta la solicitud.
	return true; 
}

// Callback to inform the connection parameter update
void on_le_param_updated(struct bt_conn *conn, uint16_t interval, uint16_t latency, uint16_t timeout)
{
	double connection_interval = interval*1.25;         // in ms
	uint16_t supervision_timeout = timeout*10;          // in ms
	LOG_INF("Connection parameters updated: interval %.2f ms, latency %d intervals, timeout %d ms", connection_interval, latency, supervision_timeout);
}

// Callback to inform the update of PHY
void on_le_phy_updated(struct bt_conn *conn, struct bt_conn_le_phy_info *param)
{
	if (param->tx_phy == BT_CONN_LE_TX_POWER_PHY_1M) {LOG_INF("PHY updated. New PHY: 1M");}
	else if (param->tx_phy == BT_CONN_LE_TX_POWER_PHY_2M) {LOG_INF("PHY updated. New PHY: 2M");}
	else if (param->tx_phy == BT_CONN_LE_TX_POWER_PHY_CODED_S8) {LOG_INF("PHY updated. New PHY: Long Range");}
}

// Callback to inform the update of data length
void on_le_data_len_updated(struct bt_conn *conn, struct bt_conn_le_data_len_info *info)
{
	uint16_t tx_len  = info->tx_max_len; 
	uint16_t tx_time = info->tx_max_time;
	uint16_t rx_len  = info->rx_max_len;
	uint16_t rx_time = info->rx_max_time;
	LOG_INF("Data length updated. Length %d/%d bytes, time %d/%d us", tx_len, rx_len, tx_time, rx_time);
}

// Callback structure for connections events
struct bt_conn_cb connection_callbacks = {
	.connected				= on_connected,
	.disconnected			= on_disconnected,
	.recycled				= recycled_cb,
	.le_param_req			= le_param_req,
	.security_changed		= security_changed,
	.le_param_updated		= on_le_param_updated,		// Uso opcional solo informan
	.le_phy_updated			= on_le_phy_updated,		// Uso opcional solo informan
	.le_data_len_updated    = on_le_data_len_updated,	// Uso opcional solo informan
};

// Callback function for receiving data from the Exercise Detection characteristic
static void app_exercise_detec_cb(const uint8_t *buf, uint16_t len)
{
	LOG_HEXDUMP_INF(buf, len, "Datos recibidos en Exercise Detection Char:");

	if (len == 1) {
		// Iniciar muestreo
		if (buf[0] == 0xAA) {
			start_send = true;
			packet_counter = 0;
			first_sample_taken = false;
			k_sem_take(&ble_data_sem, K_NO_WAIT); 
			k_timer_start(&sensor_timer, K_MSEC(START_DELAY_MS), K_USEC(SAMPLING_PERIOD_US));
		}

		// Detener muestreo
		if (buf[0] == 0xFF) {
			k_timer_stop(&sensor_timer);
			start_send = false;
		}
	}
}

static struct my_imus_cb app_callbacks = {
	.exdetection_write_cb = app_exercise_detec_cb, 	// Exercise detection callback
};

// Callback a llamar cuando el BLE este listo
static void bt_ready(int err)
{
	if (err) {
		LOG_ERR("Bluetooth init failed (err %d)", err);
		return;
	}
	LOG_INF("Bluetooth initialized");

    // !!! BORRAR CLAVES DE EMPAREJAMIENTO ANTERIORES !!!
    // SOLO PARA DEPURACIÓN. Quitar en producción.
    // bt_unpair(BT_ID_DEFAULT, BT_ADDR_LE_ANY);
    // LOG_INF("Cleared all bonding information.");
	// k_msleep(200);

	// Inicializa el subsistema de settings y carga la configuración de la flash
	if (IS_ENABLED(CONFIG_SETTINGS)) {
        settings_load();
        LOG_INF("Settings loaded.");
    }
	k_msleep(200);

	// Ahora que BT está listo, podemos inicializar nuestro servicio y empezar a anunciar
	err = my_imus_init(&app_callbacks);
	if (err) {
		LOG_ERR("Fail to init IMU Service (err %d)", err);
		return;
	}

	// Iniciar advertising. No es necesario el k_work aquí
	start_advertising();

	// Obtener y mostrar la dirección BLE
	bt_addr_le_t addr;
	size_t count = 1;
	char addr_str[BT_ADDR_LE_STR_LEN];
	// Usamos bt_id_get que es seguro llamar después de que bt_enable ha completado.
	bt_id_get(&addr, &count); 
	bt_addr_le_to_str(&addr, addr_str, sizeof(addr_str));
	LOG_INF("BLE Name=%s, Address=%s", CONFIG_BT_DEVICE_NAME, addr_str);
}

static void auth_cancel(struct bt_conn *conn)
{
	char addr[BT_ADDR_LE_STR_LEN];
	bt_addr_le_to_str(bt_conn_get_dst(conn), addr, sizeof(addr));
	LOG_WRN("Pairing cancelled for %s", addr);
}

// Estructura de callbacks para "Just Works"
static struct bt_conn_auth_cb auth_cb_display = {
	.cancel = auth_cancel,
};

// MAIN FUNCTION ********************************************************************
int main(void)
{
	int err;
	//================================================================================
	//                                  1. LED'S
	//================================================================================
	if (!gpio_is_ready_dt(&red_led) && !gpio_is_ready_dt(&grn_led) && !gpio_is_ready_dt(&blu_led)) {
		LOG_ERR("Error led gpio\n");
		return -1;
	}
	gpio_pin_configure_dt(&red_led, GPIO_OUTPUT_ACTIVE);
	gpio_pin_configure_dt(&grn_led, GPIO_OUTPUT_ACTIVE);
	gpio_pin_configure_dt(&blu_led, GPIO_OUTPUT_ACTIVE);
	gpio_pin_set_dt(&red_led, 1);
	gpio_pin_set_dt(&grn_led, 0);
	gpio_pin_set_dt(&blu_led, 0);

	//================================================================================
	//                                 2. SENSOR
	//================================================================================
	if (!device_is_ready(i2c1_dev)) {
		LOG_ERR("I2C-1 not ready");
		return -1;
	}

	LOG_INF("Starting IMU-Node. Hardware OK.");

	if (!bno055_init(i2c1_dev, BNO_OPR_MODE_NDOF)) {
		LOG_ERR("BNO055 init failed.");
		gpio_pin_set_dt(&red_led, 1);
		return -1;
	} else {
		LOG_INF("BNO055 init OK.");
		bno055_change_crystal(true);
		uint8_t config_values[5];
		bno055_read_config(config_values, false);
		units = config_values[3];
	}

	//================================================================================
	//                            3. TOMA DE MUESTRAS
	//================================================================================
	// Inicializar Mutex y Semáforo PRIMERO
	k_mutex_init(&packet_mutex);
	k_sem_init(&ble_data_sem, 0, 1);

	// Cola de trabajo dedicada
	k_work_queue_start(&sensor_work_q, sensor_work_q_stack, K_KERNEL_STACK_SIZEOF(sensor_work_q_stack),
		K_PRIO_COOP(GETSAMPLE_PRIORITY), NULL);
	k_work_init(&sensor_work, sensor_work_handler);

	// Inicializar el temporizador
	k_timer_init(&sensor_timer, timer_expiry_function, NULL);
	// LOG_INF("Kernel objects for sampling are initialized.");

	// Hilo de envío BLE (Thread)
	send_thread_tid = k_thread_create(&send_thread_data, send_thread_stack, K_KERNEL_STACK_SIZEOF(send_thread_stack), 
		send_data_thread, NULL, NULL, NULL, SEND_PRIORITY, 0, K_NO_WAIT);

	if (!send_thread_tid) {
		LOG_ERR("Failed to create send_data_thread");
		return -1;
	}
	k_thread_name_set(send_thread_tid, "ble_send_thread");
	// LOG_INF("BLE Send Thread created.");

	//================================================================================
	//                               4. BLUETOOTH
	//================================================================================
	k_work_init(&adv_restart_work, adv_restart_work_handler);
	bt_conn_cb_register(&connection_callbacks);
	
	bt_conn_auth_cb_register(&auth_cb_display);
	LOG_INF("Authentication callbacks registered.");

	// Eneable the bluetooth stack
	err = bt_enable(bt_ready);
	if (err) {
		LOG_ERR("Bluetooth init failed (err %d)\n", err);
		return -1;
	}
	
	//================================================================================
	//                                LED Blink
	//================================================================================
	gpio_pin_set_dt(&red_led, 0);
	for (;;) {
		k_msleep(2000);
		if (connect) {
			gpio_pin_toggle_dt(&blu_led);
			gpio_pin_set_dt(&grn_led, 0);
		} else {
			gpio_pin_toggle_dt(&grn_led);
			gpio_pin_set_dt(&blu_led, 0);
		}
	}
}
```

## src/my_imu_ble_service.c
```c
/** @file
 *  @brief IMU Service (IMUS)
 */

#include <zephyr/types.h>
#include <stddef.h>
#include <string.h>
#include <errno.h>
#include <zephyr/sys/printk.h>
#include <zephyr/sys/byteorder.h>
#include <zephyr/kernel.h>
#include <zephyr/logging/log.h>
#include <zephyr/bluetooth/bluetooth.h>
#include <zephyr/bluetooth/hci.h>
#include <zephyr/bluetooth/conn.h>
#include <zephyr/bluetooth/uuid.h>
#include <zephyr/bluetooth/gatt.h>
#include "my_imu_ble_service.h"

LOG_MODULE_DECLARE(IMU, LOG_LEVEL_INF);

// Static variables of the service
static bool notify_enabled = false;	// Flag notification of MySensor characteristic is enabled by a client
static bool indicate_enabled = false;

static struct my_imus_cb imus_cb;
static struct bt_gatt_indicate_params ind_params;

// Callback function of configuration change of CCCD (Client Characteristic Configuration Descriptor)
// Notify if the client is subscribed to the SensorData NOTIFY-characteristic
static void my_imus_ccc_sensordata_cfg_changed(const struct bt_gatt_attr *attr, uint16_t value)
{notify_enabled = (value == BT_GATT_CCC_NOTIFY);}

// Callback function of configuration change of CCCD (Client Characteristic Configuration Descriptor)
// Notify if the client is subscribed to the ExDetection INDICATE-characteristic
static void my_imus_ccc_excdetection_cfg_changed(const struct bt_gatt_attr *attr, uint16_t value)
{indicate_enabled = (value == BT_GATT_CCC_INDICATE);}

// Callbak when an AKC is received
static void indicate_cb(struct bt_conn *conn, struct bt_gatt_indicate_params *params, uint8_t err)
{
	// LOG_INF("Indication %s", err != 0U ? "fail" : "success");
}

// Callback function for writing to the ExDetection characteristic
static ssize_t write_exdetection(struct bt_conn *conn, const struct bt_gatt_attr *attr, const void *buf, 
								uint16_t len, uint16_t offset, uint8_t flags)
{
    if (imus_cb.exdetection_write_cb) {			// Is a callback function defined?
        imus_cb.exdetection_write_cb(buf, len);	// Call the callback function with the received data
        return len;								// Return the number of bytes written
    }
    return BT_GATT_ERR(BT_ATT_ERR_WRITE_NOT_PERMITTED);	// If no callback is defined, return NOT WRITE PERMITTED
}

/* IMU Service Declaration */
BT_GATT_SERVICE_DEFINE(
	// Atributes of the IMU Service
	// attrs[0]: IMU Service declaration.
	// attrs[1]: SensorData Characteristic declaration.
	// attrs[2]: CCCD of SensorData.
	// attrs[3]: Exercise Detection declaration.
	// attrs[4]: Value of Exercise Detection (Write and Indicate operations).
	// attrs[5]: CCCD of Exercise Detection.

	my_imus_svc, BT_GATT_PRIMARY_SERVICE(BT_UUID_IMUS),
	/* 1. Send Data characteristic and its CCCD  */
	BT_GATT_CHARACTERISTIC(
		BT_UUID_IMUS_DATA,			// UUID of the characteristic
		BT_GATT_CHRC_NOTIFY,		// Properties of the characteristic
		BT_GATT_PERM_READ_ENCRYPT,	// Permissions of the characteristic
		NULL,						// Read callback function (not used)
		NULL,						// Write callback function (not used)
		NULL						// User data (not used)
	),
	BT_GATT_CCC(my_imus_ccc_sensordata_cfg_changed, BT_GATT_PERM_READ | BT_GATT_PERM_WRITE),

	/* 2. Exercise Detection characteristic and its CCCD  */
	BT_GATT_CHARACTERISTIC(
		BT_UUID_IMUS_EXDETECTION,
		BT_GATT_CHRC_INDICATE | BT_GATT_CHRC_WRITE,
		BT_GATT_PERM_READ_ENCRYPT | BT_GATT_PERM_WRITE_ENCRYPT,
		NULL,
		write_exdetection,
		NULL),
	BT_GATT_CCC(my_imus_ccc_excdetection_cfg_changed, BT_GATT_PERM_READ | BT_GATT_PERM_WRITE),
);

// PUBLIC API FUNCTIONS *******************************************************

// Initialize the IMU Service with the provided callbacks
int my_imus_init(struct my_imus_cb *callbacks)
{
    if (callbacks) {
        imus_cb.exdetection_write_cb = callbacks->exdetection_write_cb;
	}
    return 0;
}

// Function to send indications for the Excercise Detection characteristic
int my_imus_exercisedetection_indicate(const uint8_t *data, uint16_t len)
{
    if (!indicate_enabled) {
        return -EACCES;
    }

    // Config parameters for the indication
    ind_params.attr = &my_imus_svc.attrs[4];
    ind_params.func = indicate_cb;
    ind_params.destroy = NULL;
    ind_params.data = data;
    ind_params.len = len;

    return bt_gatt_indicate(NULL, &ind_params);
}

// Function to get the indicate enable status
bool get_imus_exercisedetection_indicate_enabled(void) {return indicate_enabled;}

// Function to send notifications for the Data characteristic
int my_imus_sensordata_notify(const uint8_t *sensor_data, uint16_t send_bytes)
{
	if (!notify_enabled) {return -EACCES;}
	return bt_gatt_notify(NULL, &my_imus_svc.attrs[1], sensor_data, send_bytes);
}

// Function to get the notification enable status
bool get_imus_sensordata_notify_enabled(void) {return notify_enabled;}
```
